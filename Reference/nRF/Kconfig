## Reference/nRF/Kconfig
```kconfig
# JUXTA nRF Project Configuration
#
# Copyright (c) 2024 NeurotechHub
# SPDX-License-Identifier: Apache-2.0

# Source the libraries configuration
source "lib/Kconfig"

# Standard Zephyr configuration
menu "Zephyr"
source "Kconfig.zephyr"
endmenu 
```

## Reference/nRF/boards/NeurotechHub/Juxta5-1_ADC/Juxta5-1_ADC_defconfig
```kconfig
# Hardware Protection
CONFIG_ARM_MPU=y
CONFIG_HW_STACK_PROTECTION=y

# Essential Hardware Peripherals
CONFIG_GPIO=y
CONFIG_SPI=y
CONFIG_SPI_NRFX=y
CONFIG_ADC=y
CONFIG_ADC_NRFX_SAADC=y
CONFIG_RTC=y
CONFIG_COUNTER=y

# Hardware Limitations
CONFIG_UART_NRFX=n
CONFIG_UART_CONSOLE=n

# Default Console (RTT)
CONFIG_USE_SEGGER_RTT=y
CONFIG_RTT_CONSOLE=y
CONFIG_CONSOLE=y
```

## Reference/nRF/boards/NeurotechHub/Juxta5-1_AXY/Juxta5-1_AXY_defconfig
```kconfig
CONFIG_ARM_MPU=y
CONFIG_HW_STACK_PROTECTION=y

# Enable GPIO
CONFIG_GPIO=y

# Enable SPI
CONFIG_SPI=y
CONFIG_SPI_NRFX=y

# Enable Sensor support for accelerometer
CONFIG_SENSOR=y

# Enable FRAM support (for future integration)
CONFIG_EEPROM=y
CONFIG_EEPROM_AT25=y
```

## Reference/nRF/boards/NeurotechHub/Juxta5-4_nRF52840/board.yml
```yaml
board:
  name: Juxta5-4_nRF52840
  vendor: NeurotechHub
  socs:
    - name: nrf52840
```

## Reference/nRF/boards/NeurotechHub/Juxta5-6_nRF52840/board.yml
```yaml
board:
  name: Juxta5-6_nRF52840
  vendor: NeurotechHub
  socs:
    - name: nrf52840
```

## Reference/nRF/lib/Kconfig
```kconfig
# Libraries Configuration
#
# Copyright (c) 2024 NeurotechHub
# SPDX-License-Identifier: Apache-2.0

source "lib/juxta_fram/Kconfig"
source "lib/juxta_framfs/Kconfig"
source "lib/juxta_vitals_nrf52/Kconfig" 
```

## Reference/nRF/lib/juxta_fram/Kconfig
```kconfig
# JUXTA FRAM Library Configuration
#
# Copyright (c) 2024 NeurotechHub
# SPDX-License-Identifier: Apache-2.0

config JUXTA_FRAM
	bool "JUXTA FRAM Library"
	depends on SPI && GPIO
	help
	  Enable the JUXTA FRAM library for communicating with
	  MB85RS1MT FRAM memory devices over SPI.
	  
	  This library provides a clean API for:
	  - Device initialization and ID verification
	  - Reading and writing data
	  - Error handling and logging
	  
	  Requires SPI and GPIO drivers to be enabled.

if JUXTA_FRAM

module = JUXTA_FRAM
module-str = juxta_fram
source "subsys/logging/Kconfig.template.log_config"

config JUXTA_FRAM_INIT_PRIORITY
	int "JUXTA FRAM library initialization priority"
	default 70
	help
	  Initialization priority for the JUXTA FRAM library.
	  Must be higher than SPI and GPIO driver priorities.

endif # JUXTA_FRAM 
```

## Reference/nRF/lib/juxta_framfs/Kconfig
```kconfig
config JUXTA_FRAMFS
	bool "JUXTA FRAM File System Library"
	depends on JUXTA_FRAM
	help
	  Enable the JUXTA FRAM file system library. This provides a simple
	  append-only file system on top of the JUXTA FRAM driver.

if JUXTA_FRAMFS

config JUXTA_FRAMFS_LOG_LEVEL
	int "JUXTA FRAMFS Log Level"
	default 3
	range 0 4
	help
	  Sets log level for JUXTA FRAMFS library.
	  0 = OFF, 1 = ERROR, 2 = WARNING, 3 = INFO, 4 = DEBUG

config JUXTA_FRAMFS_FILENAME_LEN
	int "Maximum filename length"
	default 8
	range 6 12
	help
	  Maximum length of filenames including null terminator.
	  Default 8 supports YYMMDD format (6 chars + null).
	  Must be a multiple of 4 for alignment.

endif # JUXTA_FRAMFS 
```

## Reference/nRF/lib/juxta_vitals_nrf52/Kconfig
```kconfig
# Copyright (c) 2024 NeurotechHub
# SPDX-License-Identifier: Apache-2.0

# JUXTA Vitals Library Configuration
#
# Copyright (c) 2024 NeurotechHub
# SPDX-License-Identifier: Apache-2.0

config JUXTA_VITALS_NRF52
	bool "JUXTA Vitals Library for nRF52"
	depends on ADC
	help
	  Enable JUXTA Vitals Library for nRF52.
	  This library provides battery voltage, temperature,
	  and system vitals monitoring.

if JUXTA_VITALS_NRF52

config JUXTA_VITALS_NRF52_BATTERY_UPDATE_INTERVAL
	int "Battery update interval (seconds)"
	default 60
	range 10 3600
	help
	  How often to update battery voltage reading.

config JUXTA_VITALS_NRF52_VOLTAGE_DIVIDER
	bool "Enable voltage divider scaling"
	default y
	help
	  Enable voltage divider scaling for battery voltage.
	  This should be enabled when using a voltage divider
	  to measure battery voltage.

config JUXTA_VITALS_NRF52_VOLTAGE_DIVIDER_RATIO
	int "Voltage divider ratio (x1000)"
	default 9333  # (1.5M + 180k) / 180k = 9.333
	depends on JUXTA_VITALS_NRF52_VOLTAGE_DIVIDER
	help
	  Voltage divider ratio multiplied by 1000.
	  For example, if using 1.5M + 180k voltage divider:
	  ratio = (1.5M + 180k) / 180k = 9.333
	  value = 9333

module = JUXTA_VITALS_NRF52
module-str = juxta_vitals_nrf52
source "subsys/logging/Kconfig.template.log_config"

endif # JUXTA_VITALS_NRF52 
```
