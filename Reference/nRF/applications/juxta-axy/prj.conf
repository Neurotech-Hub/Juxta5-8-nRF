## CMakeLists.txt
```
cmake_minimum_required(VERSION 3.13.1)
find_package(Zephyr REQUIRED HINTS $ENV{ZEPHYR_BASE})

project(juxta-axy LANGUAGES C)

# Add STMicroelectronics LIS2DH12 library include path
target_include_directories(app PRIVATE 
    ${CMAKE_CURRENT_SOURCE_DIR}/../../lib/lisd2h12
)

target_sources(app PRIVATE 
    src/main.c
    src/juxta_axy_example.c
    src/lis2dh12_zephyr.c
    ${CMAKE_CURRENT_SOURCE_DIR}/../../lib/lisd2h12/lis2dh12_reg.c
)

# Future FRAM integration: Add conditional compilation here
# target_sources_ifdef(CONFIG_JUXTA_FRAM app PRIVATE src/fram_integration.c) 
```

## sample.yaml
```
sample:
  name: JUXTA-AXY Accelerometer Example
  description: >
    Low-power accelerometer playground application for JUXTA-AXY boards.
    Demonstrates LIS2DH12 accelerometer communication, magnet sensor interrupt,
    and LED control. Based on juxta-mvp but focused on accelerometer functionality.

common:
  tags:
    - accelerometer
    - lis2dh12
    - low-power
    - interrupt
    - spi
    - gpio
    - juxta

tests:
  applications.juxta-axy:
    tags:
      - accelerometer
      - lis2dh12
      - juxta
    platform_allow:
      - Juxta5-1_AXY
    extra_configs:
      - CONFIG_SPI=y
      - CONFIG_GPIO=y
      - CONFIG_LOG=y
      - CONFIG_PM=y
    harness: console
    harness_config:
      type: one_line
      regex:
        - "✅ LIS2DH12 WHO_AM_I verified: 0x33"
```

## prj.conf
```kconfig
# JUXTA-AXY Application Configuration
# Accelerometer playground based on juxta-mvp

# Enable SPI for accelerometer communication
CONFIG_SPI=y
CONFIG_SPI_NRFX=y

# Enable GPIO for magnet sensor interrupt and LED
CONFIG_GPIO=y

# Enable logging
CONFIG_LOG=y
CONFIG_LOG_DEFAULT_LEVEL=3

# Enable RTT for logging (since no UART available)
CONFIG_USE_SEGGER_RTT=y
CONFIG_CONSOLE=y
CONFIG_RTT_CONSOLE=y
CONFIG_SEGGER_RTT_MODE_NO_BLOCK_SKIP=y
# Disable UART console (since no UART available)
CONFIG_UART_CONSOLE=n

# Kernel configuration
CONFIG_MAIN_STACK_SIZE=2048
CONFIG_SYSTEM_WORKQUEUE_STACK_SIZE=2048

# Future FRAM integration points:
# CONFIG_EEPROM=y  # Enable when combining with FRAM
# CONFIG_EEPROM_AT25=y
# CONFIG_JUXTA_FRAM=y  # Enable when combining with FRAM
# CONFIG_JUXTA_FRAM_LOG_LEVEL_DBG=y 
```

## src/main.c
```c
/*
 * JUXTA-AXY Application - Accelerometer Playground
 * Based on juxta-mvp but focused on LIS2DH12 accelerometer functionality
 *
 * Copyright (c) 2024 NeurotechHub
 * SPDX-License-Identifier: Apache-2.0
 */

#include <zephyr/kernel.h>
#include <zephyr/logging/log.h>

LOG_MODULE_REGISTER(main, LOG_LEVEL_INF);

/* External function from juxta_axy_example.c */
extern int juxta_axy_example_main(void);

int main(void)
{
    LOG_INF("Starting JUXTA-AXY Application v1.0");
    LOG_INF("Accelerometer playground with LIS2DH12 support");

    return juxta_axy_example_main();
}
```

## src/juxta_axy_example.c
```c
/*
 * JUXTA-AXY Example Application
 *
 * This demonstrates how to use the LIS2DH12 accelerometer, GPIO interrupt, and LED
 * with low-power sleep until magnet sensor interrupt. This is an accelerometer
 * playground based on the juxta-mvp application.
 *
 * Key differences from juxta-mvp:
 * - Removed FRAM functionality (no P0.20 CS conflict)
 * - Removed ADC functionality (P0.04/P0.05 used for accelerometer)
 * - Added LIS2DH12 accelerometer support
 * - Kept magnet sensor interrupt and LED functionality
 * - Kept low-power sleep functionality
 *
 * Future FRAM integration: This application can be extended to include FRAM
 * functionality from the juxta_fram library for data logging purposes.
 */

#include <zephyr/kernel.h>
#include <zephyr/device.h>
#include <zephyr/drivers/gpio.h>
#include <zephyr/drivers/spi.h>
#include <zephyr/logging/log.h>
#include <zephyr/pm/pm.h>
#include <string.h>

#include "lis2dh12_zephyr.h"

LOG_MODULE_REGISTER(juxta_axy_example, LOG_LEVEL_DBG);

/* Device tree definitions */
#define MAGNET_SENSOR_NODE DT_ALIAS(magnet_sensor)
#define LED_NODE DT_ALIAS(led0)
#define ACCEL_NODE DT_ALIAS(spi_accel)
#define ACCEL_INT_NODE DT_ALIAS(accel_int)

/* GPIO specifications */
static const struct gpio_dt_spec magnet_sensor = GPIO_DT_SPEC_GET(MAGNET_SENSOR_NODE, gpios);
static const struct gpio_dt_spec led = GPIO_DT_SPEC_GET(LED_NODE, gpios);
static const struct gpio_dt_spec accel_int = GPIO_DT_SPEC_GET(ACCEL_INT_NODE, gpios);

/* Callback data */
static struct gpio_callback magnet_cb_data;

/* Semaphore for signaling magnet sensor interrupt */
static K_SEM_DEFINE(magnet_sem, 0, 1);

/* Counter for magnet sensor events */
static uint32_t magnet_event_count = 0;

/* Accelerometer device */
static struct lis2dh12_zephyr_dev accel_dev;

/**
 * @brief Magnet sensor interrupt callback
 */
void magnet_sensor_callback(const struct device *dev, struct gpio_callback *cb, uint32_t pins)
{
    magnet_event_count++;

    LOG_INF("🧲 Magnet sensor interrupt triggered! (Event #%u)", magnet_event_count);

    /* Signal the main thread that an interrupt occurred */
    k_sem_give(&magnet_sem);
}

/**
 * @brief Initialize magnet sensor interrupt
 */
static int init_magnet_sensor(void)
{
    int ret;

    if (!gpio_is_ready_dt(&magnet_sensor))
    {
        LOG_ERR("Magnet sensor GPIO not ready");
        return -ENODEV;
    }

    ret = gpio_pin_configure_dt(&magnet_sensor, GPIO_INPUT);
    if (ret < 0)
    {
        LOG_ERR("Failed to configure magnet sensor pin: %d", ret);
        return ret;
    }

    ret = gpio_pin_interrupt_configure_dt(&magnet_sensor, GPIO_INT_EDGE_TO_ACTIVE);
    if (ret < 0)
    {
        LOG_ERR("Failed to configure magnet sensor interrupt: %d", ret);
        return ret;
    }

    gpio_init_callback(&magnet_cb_data, magnet_sensor_callback, BIT(magnet_sensor.pin));
    gpio_add_callback(magnet_sensor.port, &magnet_cb_data);

    LOG_INF("Magnet sensor initialized on pin %d (interrupt on rising edge)", magnet_sensor.pin);
    return 0;
}

/**
 * @brief Initialize LED (no longer shared with FRAM CS)
 */
static int init_led(void)
{
    int ret;

    if (!gpio_is_ready_dt(&led))
    {
        LOG_ERR("LED GPIO not ready");
        return -ENODEV;
    }

    ret = gpio_pin_configure_dt(&led, GPIO_OUTPUT_INACTIVE);
    if (ret < 0)
    {
        LOG_ERR("Failed to configure LED pin: %d", ret);
        return ret;
    }

    LOG_INF("LED initialized on pin %d", led.pin);
    return 0;
}

/**
 * @brief Initialize LIS2DH12 accelerometer
 */
static int init_accelerometer(void)
{
    int ret;

    LOG_INF("Initializing LIS2DH12 accelerometer...");

    /* Initialize the accelerometer device */
    ret = lis2dh12_zephyr_init(&accel_dev, NULL, &accel_int);
    if (ret < 0)
    {
        LOG_ERR("Failed to initialize LIS2DH12: %d", ret);
        return ret;
    }

    /* Test basic communication */
    ret = lis2dh12_zephyr_test(&accel_dev);
    if (ret < 0)
    {
        LOG_ERR("LIS2DH12 test failed: %d", ret);
        return ret;
    }

    LOG_INF("LIS2DH12 accelerometer initialized successfully");
    return 0;
}

/**
 * @brief Test accelerometer communication
 */
static int test_accelerometer(void)
{
    int ret;

    LOG_INF("Testing LIS2DH12 accelerometer communication...");

    /* Verify WHO_AM_I register */
    ret = lis2dh12_zephyr_verify_who_am_i(&accel_dev);
    if (ret < 0)
    {
        LOG_ERR("WHO_AM_I verification failed: %d", ret);
        return ret;
    }

    /* Read device ID directly */
    uint8_t device_id = 0;
    ret = lis2dh12_zephyr_read_device_id(&accel_dev, &device_id);
    if (ret < 0)
    {
        LOG_ERR("Failed to read device ID: %d", ret);
        return ret;
    }

    LOG_INF("✅ LIS2DH12 communication verified - Device ID: 0x%02X", device_id);
    return 0;
}

/**
 * @brief Flash LED to indicate activity
 */
static void flash_led(void)
{
    LOG_DBG("Flashing LED to indicate activity");
    gpio_pin_set_dt(&led, 1);
    k_msleep(100);
    gpio_pin_set_dt(&led, 0);
}

/**
 * @brief Handle wake-up activities after magnet sensor interrupt
 */
static void handle_magnet_event(void)
{
    LOG_INF("🔋 Device woke up from sleep due to magnet sensor!");

    /* Test accelerometer communication */
    LOG_INF("📊 Testing accelerometer communication after wake-up...");
    test_accelerometer();

    /* Flash LED to indicate activity */
    flash_led();

    /*
     * Future FRAM integration point:
     * Here you would store the event data and accelerometer readings
     * to FRAM for persistence across power cycles:
     *
     * if (CONFIG_JUXTA_FRAM) {
     *     fram_store_event(magnet_event_count, accel_data);
     * }
     */

    LOG_INF("✅ Event processing complete. Returning to sleep...");
}

/**
 * @brief Main application entry point
 */
int juxta_axy_example_main(void)
{
    int ret;

    LOG_INF("Starting JUXTA-AXY Low-Power Accelerometer Example");
    LOG_INF("Board: Juxta5-1_AXY (Accelerometer variant)");

    /* Initialize peripherals */
    ret = init_magnet_sensor();
    if (ret < 0)
    {
        LOG_ERR("Failed to initialize magnet sensor: %d", ret);
        return ret;
    }

    ret = init_led();
    if (ret < 0)
    {
        LOG_ERR("Failed to initialize LED: %d", ret);
        return ret;
    }

    ret = init_accelerometer();
    if (ret < 0)
    {
        LOG_ERR("Failed to initialize accelerometer: %d", ret);
        return ret;
    }

    LOG_INF("All peripherals initialized successfully");

    /* Initial accelerometer test */
    LOG_INF("🧪 Performing initial accelerometer test...");
    ret = test_accelerometer();
    if (ret < 0)
    {
        LOG_ERR("Initial accelerometer test failed: %d", ret);
        return ret;
    }

    /* Flash LED to indicate successful initialization */
    flash_led();
    k_msleep(200);
    flash_led();

    LOG_INF("🔋 Entering low-power mode - device will sleep until magnet sensor interrupt");
    LOG_INF("🧲 Trigger the magnet sensor (P0.%02d) to wake the device", magnet_sensor.pin);
    LOG_INF("🚀 Each wake-up will test LIS2DH12 WHO_AM_I communication");

    /* Main loop - sleep until interrupt */
    while (1)
    {
        /* Wait for magnet sensor interrupt (blocks until interrupt occurs) */
        ret = k_sem_take(&magnet_sem, K_FOREVER);
        if (ret == 0)
        {
            /* Process the magnet sensor event */
            handle_magnet_event();
        }

        /* Brief delay before going back to sleep */
        k_msleep(100);

        LOG_INF("💤 Going back to sleep... (Event count: %u)", magnet_event_count);
    }

    return 0;
}
```

## src/lis2dh12_zephyr.c
```c
/*
 * LIS2DH12 Zephyr Integration Layer Implementation
 * Wraps STMicroelectronics LIS2DH12 library for Zephyr SPI
 *
 * Copyright (c) 2024 NeurotechHub
 * SPDX-License-Identifier: Apache-2.0
 */

#include "lis2dh12_zephyr.h"
#include "lis2dh12_reg.h"
#include <zephyr/logging/log.h>
#include <string.h>

LOG_MODULE_REGISTER(lis2dh12_zephyr, LOG_LEVEL_DBG);

/* Device tree nodes */
#define SPI_NODE DT_ALIAS(spi_accel)
#define SPI_BUS DT_BUS(SPI_NODE)

/* Global context for platform functions */
static struct lis2dh12_zephyr_dev *g_lis2dh12_dev = NULL;

/**
 * @brief Platform-specific SPI read function for STMicroelectronics library
 *
 * This function implements the required interface for the library's function pointers.
 */
int32_t lis2dh12_platform_read(void *handle, uint8_t reg, uint8_t *data, uint16_t len)
{
    if (!g_lis2dh12_dev || !g_lis2dh12_dev->initialized)
    {
        LOG_ERR("LIS2DH12 device not initialized");
        return -ENODEV;
    }

    /* For SPI, set read bit (bit 7) and increment bit (bit 6) for multi-byte reads */
    uint8_t tx_reg = reg | 0x80; /* Set read bit */
    if (len > 1)
    {
        tx_reg |= 0x40; /* Set increment bit for multi-byte reads */
    }

    uint8_t tx_buf[1 + len]; /* Register + dummy bytes */
    uint8_t rx_buf[1 + len]; /* Response */

    tx_buf[0] = tx_reg;
    memset(&tx_buf[1], 0x00, len); /* Dummy bytes */

    const struct spi_buf tx_bufs = {
        .buf = tx_buf,
        .len = sizeof(tx_buf)};
    const struct spi_buf rx_bufs = {
        .buf = rx_buf,
        .len = sizeof(rx_buf)};
    const struct spi_buf_set tx = {
        .buffers = &tx_bufs,
        .count = 1};
    const struct spi_buf_set rx = {
        .buffers = &rx_bufs,
        .count = 1};

    int ret = spi_transceive(g_lis2dh12_dev->spi_dev, &g_lis2dh12_dev->spi_cfg, &tx, &rx);
    if (ret < 0)
    {
        LOG_ERR("SPI read failed: %d", ret);
        return ret;
    }

    /* Copy received data (skip first byte which is the register echo) */
    memcpy(data, &rx_buf[1], len);

    LOG_DBG("Read reg 0x%02X: %02X", reg, data[0]);
    return 0;
}

/**
 * @brief Platform-specific SPI write function for STMicroelectronics library
 *
 * This function implements the required interface for the library's function pointers.
 */
int32_t lis2dh12_platform_write(void *handle, uint8_t reg, const uint8_t *data, uint16_t len)
{
    if (!g_lis2dh12_dev || !g_lis2dh12_dev->initialized)
    {
        LOG_ERR("LIS2DH12 device not initialized");
        return -ENODEV;
    }

    /* For SPI, clear read bit (bit 7) and set increment bit (bit 6) for multi-byte writes */
    uint8_t tx_reg = reg & 0x7F; /* Clear read bit */
    if (len > 1)
    {
        tx_reg |= 0x40; /* Set increment bit for multi-byte writes */
    }

    uint8_t tx_buf[1 + len]; /* Register + data */
    tx_buf[0] = tx_reg;
    memcpy(&tx_buf[1], data, len);

    const struct spi_buf tx_bufs = {
        .buf = tx_buf,
        .len = sizeof(tx_buf)};
    const struct spi_buf_set tx = {
        .buffers = &tx_bufs,
        .count = 1};

    int ret = spi_write(g_lis2dh12_dev->spi_dev, &g_lis2dh12_dev->spi_cfg, &tx);
    if (ret < 0)
    {
        LOG_ERR("SPI write failed: %d", ret);
        return ret;
    }

    LOG_DBG("Write reg 0x%02X: %02X", reg, data[0]);
    return 0;
}

int lis2dh12_zephyr_init(struct lis2dh12_zephyr_dev *dev,
                         const struct device *spi_node,
                         const struct gpio_dt_spec *int_spec)
{
    if (!dev || !int_spec)
    {
        LOG_ERR("Invalid parameters");
        return -EINVAL;
    }

    /* Get the SPI bus device using device tree */
    const struct device *spi_dev = DEVICE_DT_GET(SPI_BUS);
    if (!device_is_ready(spi_dev))
    {
        LOG_ERR("SPI device not ready");
        return -ENODEV;
    }

    if (!gpio_is_ready_dt(int_spec))
    {
        LOG_ERR("Interrupt GPIO not ready");
        return -ENODEV;
    }

    /* Configure SPI for LIS2DH12 */
    dev->spi_dev = spi_dev;
    dev->spi_cfg.frequency = 8000000; /* 8MHz max for LIS2DH12 */
    dev->spi_cfg.operation = SPI_WORD_SET(8) | SPI_TRANSFER_MSB | SPI_MODE_CPOL | SPI_MODE_CPHA;
    dev->spi_cfg.slave = 1; /* Use slave 1 (accel@1 in device tree) */
    dev->spi_cfg.cs.delay = 0;

    /* Store interrupt GPIO spec */
    dev->int_gpio = *int_spec;

    /* Set global context for platform functions */
    g_lis2dh12_dev = dev;
    dev->initialized = true;

    LOG_INF("LIS2DH12 initialized: freq=%d Hz, slave=%d, INT=P0.%02d",
            dev->spi_cfg.frequency, dev->spi_cfg.slave, int_spec->pin);

    return 0;
}

int lis2dh12_zephyr_verify_who_am_i(struct lis2dh12_zephyr_dev *dev)
{
    if (!dev || !dev->initialized)
    {
        LOG_ERR("Device not initialized");
        return -ENODEV;
    }

    uint8_t who_am_i = 0;

    /* Create STMicroelectronics library context */
    stmdev_ctx_t ctx = {
        .write_reg = lis2dh12_platform_write,
        .read_reg = lis2dh12_platform_read,
        .handle = dev /* Not used by our implementation */
    };

    /* Use STMicroelectronics library function */
    int32_t ret = lis2dh12_device_id_get(&ctx, &who_am_i);
    if (ret != 0)
    {
        LOG_ERR("Failed to read WHO_AM_I register: %d", ret);
        return -EIO;
    }

    if (who_am_i != LIS2DH12_WHO_AM_I_VAL)
    {
        LOG_ERR("Invalid WHO_AM_I: 0x%02X (expected 0x%02X)",
                who_am_i, LIS2DH12_WHO_AM_I_VAL);
        return -ENODEV;
    }

    LOG_INF("✅ LIS2DH12 WHO_AM_I verified: 0x%02X", who_am_i);
    return 0;
}

int lis2dh12_zephyr_read_device_id(struct lis2dh12_zephyr_dev *dev, uint8_t *id)
{
    if (!dev || !dev->initialized || !id)
    {
        LOG_ERR("Invalid parameters");
        return -EINVAL;
    }

    /* Create STMicroelectronics library context */
    stmdev_ctx_t ctx = {
        .write_reg = lis2dh12_platform_write,
        .read_reg = lis2dh12_platform_read,
        .handle = dev};

    /* Use STMicroelectronics library function */
    int32_t ret = lis2dh12_device_id_get(&ctx, id);
    if (ret != 0)
    {
        LOG_ERR("Failed to read device ID: %d", ret);
        return -EIO;
    }

    LOG_DBG("Device ID read: 0x%02X", *id);
    return 0;
}

int lis2dh12_zephyr_test(struct lis2dh12_zephyr_dev *dev)
{
    if (!dev || !dev->initialized)
    {
        LOG_ERR("Device not initialized");
        return -ENODEV;
    }

    LOG_INF("🧪 Starting LIS2DH12 accelerometer test...");

    /* Test WHO_AM_I register */
    int ret = lis2dh12_zephyr_verify_who_am_i(dev);
    if (ret < 0)
    {
        LOG_ERR("❌ WHO_AM_I test failed: %d", ret);
        return ret;
    }

    /* TODO: Add more tests here as we expand functionality */
    /* Future: Test basic configuration, read acceleration data, etc. */

    LOG_INF("✅ LIS2DH12 accelerometer test passed!");
    return 0;
}
```

## src/lis2dh12_zephyr.h
```c
/*
 * LIS2DH12 Zephyr Integration Layer
 * Wraps STMicroelectronics LIS2DH12 library for Zephyr SPI
 *
 * Copyright (c) 2024 NeurotechHub
 * SPDX-License-Identifier: Apache-2.0
 */

#ifndef LIS2DH12_ZEPHYR_H_
#define LIS2DH12_ZEPHYR_H_

#include <zephyr/kernel.h>
#include <zephyr/device.h>
#include <zephyr/drivers/spi.h>
#include <zephyr/drivers/gpio.h>

#ifdef __cplusplus
extern "C"
{
#endif

    /**
     * @brief LIS2DH12 device context for Zephyr
     */
    struct lis2dh12_zephyr_dev
    {
        const struct device *spi_dev;
        struct spi_config spi_cfg;
        struct gpio_dt_spec int_gpio;
        bool initialized;
    };

/**
 * @brief LIS2DH12 WHO_AM_I register value
 */
#define LIS2DH12_WHO_AM_I_VAL 0x33

    /**
     * @brief Initialize LIS2DH12 device from device tree
     *
     * @param dev Pointer to LIS2DH12 device structure
     * @param spi_node Unused parameter (kept for compatibility)
     * @param int_spec GPIO specification for interrupt pin
     * @return 0 on success, negative error code on failure
     */
    int lis2dh12_zephyr_init(struct lis2dh12_zephyr_dev *dev,
                             const struct device *spi_node,
                             const struct gpio_dt_spec *int_spec);

    /**
     * @brief Verify WHO_AM_I register
     *
     * @param dev Pointer to initialized LIS2DH12 device
     * @return 0 on success, negative error code on failure
     */
    int lis2dh12_zephyr_verify_who_am_i(struct lis2dh12_zephyr_dev *dev);

    /**
     * @brief Read device ID using STMicroelectronics library
     *
     * @param dev Pointer to initialized LIS2DH12 device
     * @param id Pointer to store device ID
     * @return 0 on success, negative error code on failure
     */
    int lis2dh12_zephyr_read_device_id(struct lis2dh12_zephyr_dev *dev, uint8_t *id);

    /**
     * @brief Test basic accelerometer functionality
     *
     * @param dev Pointer to initialized LIS2DH12 device
     * @return 0 on success, negative error code on failure
     */
    int lis2dh12_zephyr_test(struct lis2dh12_zephyr_dev *dev);

#ifdef __cplusplus
}
#endif

#endif /* LIS2DH12_ZEPHYR_H_ */
```
