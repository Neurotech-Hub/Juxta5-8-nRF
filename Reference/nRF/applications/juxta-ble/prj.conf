## CMakeLists.txt
```
#-------------------------------------------------------------------------------
# JUXTA BLE Application
#
# Copyright (c) 2024 NeurotechHub
# SPDX-License-Identifier: Apache-2.0

cmake_minimum_required(VERSION 3.20.0)

find_package(Zephyr REQUIRED HINTS $ENV{ZEPHYR_BASE})
project(juxta_ble LANGUAGES C)

target_sources(app PRIVATE
    src/main.c
    src/ble_service.c
    src/lis2dh12.c
    src/adc.c
)

# Add include directories for our libraries
target_include_directories(app PRIVATE 
    ../../lib/juxta_vitals_nrf52/include
    ../../lib/juxta_framfs/include
    ../../lib/juxta_fram/include
    ../../lib/lisd2h12
)

# Add library source files directly
target_sources(app PRIVATE 
    ../../lib/juxta_vitals_nrf52/src/vitals.c
    ../../lib/juxta_framfs/src/framfs.c
    ../../lib/juxta_fram/src/fram.c
    ../../lib/lisd2h12/lis2dh12_reg.c
) 
```

## Kconfig
```
# JUXTA BLE Application Configuration
#
# Copyright (c) 2024 NeurotechHub
# SPDX-License-Identifier: Apache-2.0

menu "JUXTA BLE Application"

config JUXTA_BLE_RANDOMIZATION
	bool "Enable randomization for BLE operations"
	default y
	help
	  Enable randomization for BLE advertising and scanning intervals
	  to reduce collision probability in dense deployments.

config JUXTA_BLE_MOTION_GATING
	bool "Enable motion-based BLE gating"
	default y
	help
	  Enable motion-based gating that adjusts BLE intervals based on
	  motion activity to save power.

endmenu

# Include Zephyr Kconfig
source "Kconfig.zephyr"

# Include library Kconfig files
rsource "../../lib/juxta_vitals_nrf52/Kconfig"
rsource "../../lib/juxta_fram/Kconfig"
rsource "../../lib/juxta_framfs/Kconfig"
```

## sample.yaml
```
# Configuration file for nRF Connect SDK and testing tools
sample:
  description: Juxta BLE Application with LED Control
  name: juxta-ble
common:
  build_only: true
  integration_platforms:
    - Juxta5-4_nRF52840
tests:
  app.default: {}
```

## prj.conf
```kconfig
# Basic Bluetooth configuration - using observer architecture
CONFIG_BT=y
CONFIG_BT_OBSERVER=y
CONFIG_BT_PERIPHERAL=y
CONFIG_BT_DEVICE_NAME="JX_CONNECT"
CONFIG_BT_DEVICE_NAME_DYNAMIC=n
CONFIG_BT_MAX_CONN=1

# Enable maximum BLE GATT MTU (247 bytes) for efficient file transfer.
# Actual ATT_MTU is negotiated at runtime by the peer (e.g., mobile app).
CONFIG_BT_L2CAP_TX_MTU=247
CONFIG_BT_BUF_ACL_RX_SIZE=251
CONFIG_BT_BUF_ACL_TX_SIZE=251

# Additional BLE stack configuration for stability
CONFIG_BT_CTLR=y
CONFIG_BT_CTLR_ADV_EXT=n
CONFIG_BT_CTLR_SCAN_REQ_NOTIFY=n
CONFIG_BT_CTLR_SCAN_REQ_RSSI=n
CONFIG_BT_CTLR_ADV_INDICATION=n

# Counter API for nRF52 - DISABLED due to BLE conflict
# CONFIG_COUNTER=y
# CONFIG_NRFX_RTC0=y

# Random number generation
CONFIG_ENTROPY_GENERATOR=y

# RTT Configuration for debugging
CONFIG_USE_SEGGER_RTT=y
CONFIG_RTT_CONSOLE=y
CONFIG_SEGGER_RTT_BUFFER_SIZE_UP=8192
CONFIG_SEGGER_RTT_BUFFER_SIZE_DOWN=32

# Memory settings (increased for stability)
CONFIG_SYSTEM_WORKQUEUE_STACK_SIZE=2048
CONFIG_MAIN_STACK_SIZE=2048
CONFIG_ISR_STACK_SIZE=2048
CONFIG_BT_RX_STACK_SIZE=2048
CONFIG_BT_HCI_TX_STACK_SIZE=1536

# Minimal Bluetooth features
CONFIG_BT_SMP=n
CONFIG_BT_SIGNING=n
CONFIG_BT_ATT_PREPARE_COUNT=0
CONFIG_BT_PRIVACY=n
CONFIG_BT_SETTINGS=n
CONFIG_BT_BUF_EVT_RX_COUNT=2
CONFIG_BT_BUF_EVT_DISCARDABLE_COUNT=2

# Basic logging
CONFIG_LOG=y
CONFIG_LOG_DEFAULT_LEVEL=3
CONFIG_CONSOLE=y
CONFIG_LOG_BACKEND_RTT=y

# Enable drivers needed by vitals library and future FRAM integration
CONFIG_SPI=y
CONFIG_SPI_NRFX=y
CONFIG_ADC=y

# LIS2DH12 Accelerometer support - using custom driver
# CONFIG_SENSOR=y  # Disabled - using custom LIS2DH12 driver
# CONFIG_LIS2DH=y  # Disabled - using custom LIS2DH12 driver
# CONFIG_SPI_LOG_LEVEL_DBG=y
# CONFIG_SENSOR_LOG_LEVEL_DBG=y

# JUXTA Libraries
CONFIG_JUXTA_VITALS_NRF52=y
CONFIG_JUXTA_FRAM=y
CONFIG_JUXTA_FRAMFS=y

# Disable unused drivers
CONFIG_I2C=n

# Compiler optimizations
CONFIG_SIZE_OPTIMIZATIONS=y
CONFIG_COMPILER_OPT="-Os"

# Reduce kernel features
# CONFIG_MINIMAL_LIBC=y 
CONFIG_NEWLIB_LIBC=y
CONFIG_NEWLIB_LIBC_FLOAT_PRINTF=y
CONFIG_NEWLIB_LIBC_FLOAT_SCANF=y 

# Enable better fault context and debugging
CONFIG_DEBUG_THREAD_INFO=y
CONFIG_ASSERT=y 

CONFIG_THREAD_STACK_INFO=y
CONFIG_HW_STACK_PROTECTION=y

# Watchdog timer for system reliability
CONFIG_WATCHDOG=y
# Driver will be selected automatically for nRF; keep this if needed in this NCS version
CONFIG_WDT_NRFX=y
```

## src/adc.c
```c
/*
 * JUXTA ADC Module Implementation
 * Provides functionality for reading differential ADC measurements
 *
 * Copyright (c) 2025 NeurotechHub
 * SPDX-License-Identifier: Apache-2.0
 */

#include "adc.h"
#include <zephyr/drivers/adc.h>
#include <zephyr/logging/log.h>
#include <zephyr/devicetree.h>
#include <string.h>
#include <hal/nrf_rtc.h>
#include <hal/nrf_saadc.h>

LOG_MODULE_REGISTER(juxta_adc, LOG_LEVEL_INF);

/* ADC device and configuration */
static const struct device *adc_dev;
static struct adc_channel_cfg adc_cfg;
static struct adc_sequence adc_seq;
static int16_t adc_sample_buffer;
static bool adc_initialized = false;

int juxta_adc_init(void)
{
    int ret;

    /* Get ADC device */
    adc_dev = DEVICE_DT_GET(DT_NODELABEL(adc));
    if (!device_is_ready(adc_dev))
    {
        LOG_ERR("ADC device not ready");
        return -ENODEV;
    }

    LOG_INF("ADC device ready: %s", adc_dev->name);

    /* Configure ADC channel 0 for differential measurement (AIN0/AIN1) */
    memset(&adc_cfg, 0, sizeof(adc_cfg));
    adc_cfg.gain = ADC_GAIN_1_6;
    adc_cfg.reference = ADC_REF_INTERNAL;
    adc_cfg.acquisition_time = ADC_ACQ_TIME_DEFAULT;
    adc_cfg.channel_id = 0;                                     /* Use channel 0 for differential measurement */
    adc_cfg.input_positive = SAADC_CH_PSELP_PSELP_AnalogInput1; /* P0.03 */
    adc_cfg.input_negative = SAADC_CH_PSELN_PSELN_AnalogInput0; /* P0.02 */
    adc_cfg.differential = 1;

    ret = adc_channel_setup(adc_dev, &adc_cfg);
    if (ret != 0)
    {
        LOG_ERR("Failed to setup ADC channel: %d", ret);
        return ret;
    }

    /* Configure ADC sequence */
    memset(&adc_seq, 0, sizeof(adc_seq));
    adc_seq.channels = BIT(0);
    adc_seq.buffer = &adc_sample_buffer;
    adc_seq.buffer_size = sizeof(adc_sample_buffer);
    adc_seq.resolution = 12;
    adc_seq.oversampling = 1;
    adc_seq.calibrate = true;

    LOG_INF("ADC differential measurement configured:");
    LOG_INF("  Channel: %d", adc_cfg.channel_id);
    LOG_INF("  Input: AIN1 (P0.03) - AIN0 (P0.02)");
    LOG_INF("  Resolution: %d bits", adc_seq.resolution);
    LOG_INF("  Oversampling: %d", adc_seq.oversampling);
    LOG_INF("  Gain: 1/6");

    adc_initialized = true;
    return 0;
}

int juxta_adc_read_differential(int32_t *value_mv)
{
    int ret;

    if (!adc_initialized || !adc_dev)
    {
        LOG_ERR("ADC not initialized");
        return -ENODEV;
    }

    if (!value_mv)
    {
        LOG_ERR("Invalid parameter: value_mv is NULL");
        return -EINVAL;
    }

    /* Read ADC value */
    ret = adc_read(adc_dev, &adc_seq);
    if (ret != 0)
    {
        LOG_ERR("ADC read failed: %d", ret);
        return ret;
    }

    LOG_DBG("ADC raw value: %d", adc_sample_buffer);

    /* Convert to millivolts */
    *value_mv = adc_sample_buffer;
    ret = adc_raw_to_millivolts(adc_ref_internal(adc_dev),
                                adc_cfg.gain,
                                adc_seq.resolution,
                                value_mv);
    if (ret != 0)
    {
        LOG_ERR("ADC conversion failed: %d", ret);
        return ret;
    }

    LOG_DBG("ADC differential reading: %d mV (raw: %d)", *value_mv, adc_sample_buffer);
    return 0;
}

bool juxta_adc_is_ready(void)
{
    return adc_initialized && device_is_ready(adc_dev);
}

int juxta_adc_burst_sample(int32_t *samples, uint32_t max_samples,
                           uint32_t *actual_samples, uint32_t *duration_us)
{
    if (!adc_initialized || !adc_dev)
    {
        return -ENODEV;
    }

    if (!samples || !actual_samples || !duration_us)
    {
        return -EINVAL;
    }

    if (max_samples < 200)
    {
        return -EINVAL;
    }

    /* Start timing using RTC0 counter (32kHz clock) */
    uint32_t start_ticks = NRF_RTC0->COUNTER;
    uint32_t sample_count = 0;

    /* Perform burst sampling for approximately 2ms */
    while (sample_count < max_samples)
    {
        int32_t voltage_mv;
        int ret = juxta_adc_read_differential(&voltage_mv);

        if (ret == 0)
        {
            samples[sample_count] = voltage_mv;
            sample_count++;
        }
        else
        {
            /* Continue sampling even if one sample fails */
            continue;
        }

        /* Minimal delay - let ADC conversion time dominate */
        k_busy_wait(5); /* 5μs delay */
    }

    /* End timing */
    uint32_t end_ticks = NRF_RTC0->COUNTER;
    uint32_t duration_ticks = end_ticks - start_ticks;

    /* Calculate actual duration */
    *actual_samples = sample_count;
    *duration_us = (duration_ticks * 1000000) / 32768; /* Convert ticks to microseconds */

    return 0;
}
```

## src/adc.h
```c
/*
 * JUXTA ADC Module Header
 * Provides interface for reading differential ADC measurements
 *
 * Copyright (c) 2025 NeurotechHub
 * SPDX-License-Identifier: Apache-2.0
 */

#ifndef JUXTA_ADC_H_
#define JUXTA_ADC_H_

#include <zephyr/kernel.h>
#include <stdint.h>

#ifdef __cplusplus
extern "C"
{
#endif

    /**
     * @brief Initialize the ADC module for differential measurements
     *
     * This function sets up the ADC for reading differential measurements
     * on AIN0 (P0.02) and AIN1 (P0.03) using channel 0.
     *
     * @return 0 on success, negative error code on failure
     */
    int juxta_adc_init(void);

    /**
     * @brief Read a differential ADC measurement
     *
     * Reads the differential voltage between AIN0 (P0.02) and AIN1 (P0.03).
     * The measurement uses the configuration from the device tree:
     * - 12-bit resolution
     * - 8x oversampling
     * - 1/6 gain
     * - Internal reference
     *
     * @param value_mv Pointer to store the measurement result in millivolts
     * @return 0 on success, negative error code on failure
     */
    int juxta_adc_read_differential(int32_t *value_mv);

    /**
     * @brief Check if ADC module is initialized and ready
     *
     * @return true if ADC is ready, false otherwise
     */
    bool juxta_adc_is_ready(void);

    /**
     * @brief Perform a burst of ADC samples with precise timing
     *
     * Performs continuous ADC sampling for approximately 2ms with ~10μs intervals.
     * Uses RTC0 counter for precise timing measurement.
     *
     * @param samples Buffer to store ADC samples (must be at least 200 samples)
     * @param max_samples Maximum number of samples to store
     * @param actual_samples Pointer to store actual number of samples taken
     * @param duration_us Pointer to store actual duration in microseconds
     * @return 0 on success, negative error code on failure
     */
    int juxta_adc_burst_sample(int32_t *samples, uint32_t max_samples,
                               uint32_t *actual_samples, uint32_t *duration_us);

#ifdef __cplusplus
}
#endif

#endif /* JUXTA_ADC_H_ */
```

## src/ble_service.h
```c
/*
 * JUXTA BLE Service Header
 * Defines BLE service and characteristics for JUXTA Hublink protocol
 *
 * Copyright (c) 2025 NeurotechHub
 * SPDX-License-Identifier: Apache-2.0
 */

#ifndef JUXTA_BLE_SERVICE_H_
#define JUXTA_BLE_SERVICE_H_

#include <zephyr/kernel.h>
#include <stdbool.h>
#include <zephyr/bluetooth/uuid.h>
#include <zephyr/bluetooth/conn.h>

/* Forward declaration for framfs context */
struct juxta_framfs_context;

/* Forward declaration for vitals context */
struct juxta_vitals_ctx;

#ifdef __cplusplus
extern "C"
{
#endif

/* Hublink Service UUID: 57617368-5501-0001-8000-00805f9b34fb */
#define JUXTA_HUBLINK_SERVICE_UUID 0xFB, 0x34, 0x9B, 0x5F, 0x80, 0x00, 0x00, 0x80, \
                                   0x01, 0x00, 0x01, 0x55, 0x68, 0x73, 0x61, 0x57

/* Node Characteristic UUID: 57617368-5505-0001-8000-00805f9b34fb (READ) */
#define JUXTA_NODE_CHAR_UUID 0xFB, 0x34, 0x9B, 0x5F, 0x80, 0x00, 0x00, 0x80, \
                             0x01, 0x00, 0x05, 0x55, 0x68, 0x73, 0x61, 0x57

/* Gateway Characteristic UUID: 57617368-5504-0001-8000-00805f9b34fb (WRITE) */
#define JUXTA_GATEWAY_CHAR_UUID 0xFB, 0x34, 0x9B, 0x5F, 0x80, 0x00, 0x00, 0x80, \
                                0x01, 0x00, 0x04, 0x55, 0x68, 0x73, 0x61, 0x57

/* Filename Characteristic UUID: 57617368-5502-0001-8000-00805f9b34fb (READ/WRITE/INDICATE) */
#define JUXTA_FILENAME_CHAR_UUID 0xFB, 0x34, 0x9B, 0x5F, 0x80, 0x00, 0x00, 0x80, \
                                 0x01, 0x00, 0x02, 0x55, 0x68, 0x73, 0x61, 0x57

/* File Transfer Characteristic UUID: 57617368-5503-0001-8000-00805f9b34fb (READ/INDICATE) */
#define JUXTA_FILE_TRANSFER_CHAR_UUID 0xFB, 0x34, 0x9B, 0x5F, 0x80, 0x00, 0x00, 0x80, \
                                      0x01, 0x00, 0x03, 0x55, 0x68, 0x73, 0x61, 0x57

#define BT_UUID_JUXTA_HUBLINK_SERVICE BT_UUID_DECLARE_128(JUXTA_HUBLINK_SERVICE_UUID)
#define BT_UUID_JUXTA_NODE_CHAR BT_UUID_DECLARE_128(JUXTA_NODE_CHAR_UUID)
#define BT_UUID_JUXTA_GATEWAY_CHAR BT_UUID_DECLARE_128(JUXTA_GATEWAY_CHAR_UUID)
#define BT_UUID_JUXTA_FILENAME_CHAR BT_UUID_DECLARE_128(JUXTA_FILENAME_CHAR_UUID)
#define BT_UUID_JUXTA_FILE_TRANSFER_CHAR BT_UUID_DECLARE_128(JUXTA_FILE_TRANSFER_CHAR_UUID)

/* Firmware version */
#define JUXTA_FIRMWARE_VERSION "1.0.0"

/* Maximum JSON response sizes */
#define JUXTA_NODE_RESPONSE_MAX_SIZE 256
#define JUXTA_GATEWAY_COMMAND_MAX_SIZE 256
#define JUXTA_FILENAME_MAX_SIZE 64
#define JUXTA_FILE_TRANSFER_CHUNK_SIZE 512

    /**
     * @brief Initialize the JUXTA Hublink BLE service
     *
     * This function registers the JUXTA Hublink BLE service and its characteristics
     * with the Bluetooth stack.
     *
     * @return 0 on success, negative error code on failure
     */
    int juxta_ble_service_init(void);

    /**
     * @brief Get the current device ID (JX_XXXXXX format)
     *
     * @param device_id Buffer to store device ID (must be at least 10 bytes)
     * @return 0 on success, negative error code on failure
     */
    int juxta_ble_get_device_id(char *device_id);

    /**
     * @brief Set the framfs context for user settings access
     *
     * @param ctx Initialized framfs context
     */
    void juxta_ble_set_framfs_context(struct juxta_framfs_context *ctx);

    /**
     * @brief Set the vitals context for timestamp synchronization
     *
     * @param ctx Initialized vitals context
     */
    void juxta_ble_set_vitals_context(struct juxta_vitals_ctx *ctx);

    /**
     * @brief Trigger timing update callback (called when settings change)
     *
     * This function should be implemented in main.c to handle timing updates
     */
    extern void juxta_ble_timing_update_trigger(void);

    /**
     * @brief Connection established callback
     *
     * @param conn Bluetooth connection handle
     */
    void juxta_ble_connection_established(struct bt_conn *conn);

    /**
     * @brief Connection terminated callback
     */
    void juxta_ble_connection_terminated(void);

    /**
     * @brief Get current service status for debugging
     *
     * @param mtu Pointer to store current MTU size
     * @param connected Pointer to store connection status
     * @param transfer_active Pointer to store file transfer status
     * @return 0 on success, negative error code on failure
     */
    int juxta_ble_get_status(uint16_t *mtu, bool *connected, bool *transfer_active);

    /**
     * @brief Test function for gateway command functionality
     *
     * This function tests timestamp synchronization and clearMemory functionality.
     * It can be called during development to verify the implementation.
     *
     * @return 0 on success, negative error code on failure
     */
    int juxta_ble_test_gateway_commands(void);

    /**
     * @brief Set datetime synchronization callback function
     *
     * This function sets a callback that will be called when datetime is synchronized.
     * Used for production flow to track when timestamp has been updated via BLE.
     *
     * @param callback Function to call when datetime is synchronized (can be NULL)
     */
    void juxta_ble_set_datetime_sync_callback(void (*callback)(void));

#ifdef __cplusplus
}
#endif

#endif /* JUXTA_BLE_SERVICE_H_ */
```

## src/lis2dh12.h
```c
/*
 * Custom LIS2DH12 Zephyr Wrapper
 *
 * Copyright (c) 2024 NeurotechHub
 * SPDX-License-Identifier: Apache-2.0
 */

#ifndef LIS2DH12_H
#define LIS2DH12_H

#include <zephyr/kernel.h>
#include <zephyr/drivers/spi.h>
#include <zephyr/drivers/gpio.h>
#include <zephyr/logging/log.h>
#include "lis2dh12_reg.h"

/* LIS2DH12 device context */
struct lis2dh12_dev
{
    const struct device *spi_dev;
    struct spi_config spi_cfg;
    struct gpio_dt_spec cs_gpio;
    struct gpio_dt_spec int_gpio;

    bool initialized;
};

/* Function prototypes */
int lis2dh12_init(struct lis2dh12_dev *dev);
int lis2dh12_read_accel(struct lis2dh12_dev *dev, float *x, float *y, float *z);
int lis2dh12_read_temperature_lowres(struct lis2dh12_dev *dev, int8_t *temperature);
int lis2dh12_configure_motion_detection(struct lis2dh12_dev *dev,
                                        uint8_t threshold, uint8_t duration);
int lis2dh12_read_device_id(struct lis2dh12_dev *dev, uint8_t *id);
bool lis2dh12_is_ready(struct lis2dh12_dev *dev);
int lis2dh12_read_int1_source(struct lis2dh12_dev *dev, uint8_t *source);
int lis2dh12_clear_int1_interrupt(struct lis2dh12_dev *dev);
int lis2dh12_reset_motion_detection(struct lis2dh12_dev *dev);
int lis2dh12_test_interrupt_clearing(struct lis2dh12_dev *dev);
int lis2dh12_analyze_interrupt_trigger(struct lis2dh12_dev *dev);

/* Motion system management functions */
int lis2dh12_init_motion_system(void);
void lis2dh12_process_motion_events(void);
bool lis2dh12_should_use_extended_intervals(void);
uint8_t lis2dh12_get_motion_count(void);
void lis2dh12_reset_motion_count(void);

/* Platform functions for direct register access */
int32_t lis2dh12_platform_read(void *handle, uint8_t reg, uint8_t *data, uint16_t len);
int32_t lis2dh12_platform_write(void *handle, uint8_t reg, const uint8_t *data, uint16_t len);

#endif /* LIS2DH12_H */
```
