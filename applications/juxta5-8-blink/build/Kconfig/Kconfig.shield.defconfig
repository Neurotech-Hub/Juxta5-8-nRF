## applications/juxta5-8-blink/build/Kconfig/Kconfig.shield.defconfig
```kconfig
osource "/Users/gaidica/Documents/Software/Juxta5-8/boards/shields/*/Kconfig.defconfig"
osource "/opt/nordic/ncs/v3.0.2/nrf/boards/shields/*/Kconfig.defconfig"
```

## applications/juxta5-8-blink/build/Kconfig/boards/Kconfig.defconfig
```kconfig
# Load Zephyr board defconfig descriptions.
osource "/Users/gaidica/Documents/Software/Juxta5-8/boards/NeurotechHub/Juxta5-8_nRF52840/Kconfig.defconfig"
```

## applications/juxta5-8-blink/build/juxta5-8-blink/Kconfig/Kconfig.shield
```kconfig
osource "/Users/gaidica/Documents/Software/Juxta5-8/boards/shields/*/Kconfig.shield"
osource "/opt/nordic/ncs/v3.0.2/nrf/boards/shields/*/Kconfig.shield"
```

## applications/juxta5-8-blink/build/juxta5-8-blink/Kconfig/boards/Kconfig.sysbuild
```kconfig
# Load Sysbuild board Kconfig descriptions.
osource "/Users/gaidica/Documents/Software/Juxta5-8/boards/NeurotechHub/Juxta5-8_nRF52840/Kconfig.sysbuild"
```

## boards/NeurotechHub/Juxta5-8_nRF52840/Juxta5-8_nRF52840_defconfig
```kconfig
# Hardware protection
CONFIG_ARM_MPU=y
CONFIG_HW_STACK_PROTECTION=y

# Essential peripherals
CONFIG_GPIO=y
CONFIG_GPIO_NRFX=y
CONFIG_SPI=y
CONFIG_SPI_NRFX=y
CONFIG_ADC=y
CONFIG_ADC_NRFX_SAADC=y
CONFIG_SENSOR=y

# Console on RTT
CONFIG_USE_SEGGER_RTT=y
CONFIG_RTT_CONSOLE=y
CONFIG_CONSOLE=y

# No UART console on this board
CONFIG_UART_NRFX=n
CONFIG_UART_CONSOLE=n
```

## boards/NeurotechHub/Juxta5-8_nRF52840/board.yml
```yaml
board:
  name: Juxta5-8_nRF52840
  vendor: NeurotechHub
  socs:
    - name: nrf52840
```
