## CMakeLists.txt
```
cmake_minimum_required(VERSION 3.20.0)

find_package(Zephyr REQUIRED HINTS $ENV{ZEPHYR_BASE})
project(juxta5_8_axy LANGUAGES C)

target_include_directories(app PRIVATE
    ${CMAKE_CURRENT_SOURCE_DIR}/src
    ${CMAKE_CURRENT_SOURCE_DIR}/../../Reference/nRF/lib/lisd2h12
)

target_sources(app PRIVATE
    src/main.c
    src/lis2dh12_zephyr.c
    ${CMAKE_CURRENT_SOURCE_DIR}/../../Reference/nRF/lib/lisd2h12/lis2dh12_reg.c
)
```

## sample.yaml
```
sample:
  name: Juxta5-8 Accelerometer Tester
  description: >
    LIS2DH12 SPI Mode 0 bring-up app for Juxta5-8 with RTT telemetry and
    motion interrupt logging on INT1.

common:
  tags:
    - juxta
    - accelerometer
    - lis2dh12
    - spi
    - gpio

tests:
  applications.juxta5-8-axy:
    platform_allow:
      - Juxta5-8_nRF52840
    harness: console
```

## prj.conf
```kconfig
# Juxta5-8 accelerometer tester application
CONFIG_GPIO=y
CONFIG_SPI=y
CONFIG_SPI_NRFX=y

# Logging over RTT
CONFIG_LOG=y
CONFIG_LOG_DEFAULT_LEVEL=3
CONFIG_USE_SEGGER_RTT=y
CONFIG_RTT_CONSOLE=y
CONFIG_CONSOLE=y
CONFIG_SEGGER_RTT_MODE_NO_BLOCK_SKIP=y
CONFIG_UART_CONSOLE=n

# Keep stacks moderate for sensor + logging
CONFIG_MAIN_STACK_SIZE=2048
CONFIG_SYSTEM_WORKQUEUE_STACK_SIZE=2048

# P0.09/P0.10 are NFC pins on nRF52840; LED0 uses P0.09.
CONFIG_NFCT_PINS_AS_GPIOS=y
```

## src/main.c
```c
#include <zephyr/device.h>
#include <zephyr/drivers/gpio.h>
#include <zephyr/irq.h>
#include <zephyr/kernel.h>
#include <zephyr/logging/log.h>
#include <hal/nrf_gpio.h>

#include "lis2dh12_zephyr.h"

LOG_MODULE_REGISTER(juxta5_8_axy, LOG_LEVEL_INF);

#define MAGNET_NODE DT_ALIAS(magnet_sensor)
#define LED_NODE DT_ALIAS(led0)
#define ACCEL_INT_NODE DT_ALIAS(accel_int)

#define SAMPLE_PERIOD_MS 1000
#define MOTION_THRESHOLD_MG 16
#define MOTION_DURATION_SAMPLES 0

static const struct gpio_dt_spec magnet = GPIO_DT_SPEC_GET(MAGNET_NODE, gpios);
static const struct gpio_dt_spec led = GPIO_DT_SPEC_GET(LED_NODE, gpios);
static const struct gpio_dt_spec accel_int = GPIO_DT_SPEC_GET(ACCEL_INT_NODE, gpios);
static const struct device *const gpio1_dev = DEVICE_DT_GET(DT_NODELABEL(gpio1));

static struct gpio_callback accel_int_cb;
static volatile uint32_t motion_events;
static struct lis2dh12_dev lis2dh12;

static int magnet_read_fallback(void)
{
	uint32_t absolute_pin = magnet.pin;

	if (magnet.port == gpio1_dev)
	{
		absolute_pin += 32U;
	}

	return nrf_gpio_pin_read(absolute_pin) ? 1 : 0;
}

static void accel_int_callback(const struct device *port, struct gpio_callback *cb, uint32_t pins)
{
	ARG_UNUSED(port);
	ARG_UNUSED(cb);
	ARG_UNUSED(pins);

	motion_events++;
}

int main(void)
{
	int ret;
	uint32_t sample_seq = 0;
	bool warned_magnet_fallback = false;

	if (!gpio_is_ready_dt(&led) || !gpio_is_ready_dt(&magnet) || !gpio_is_ready_dt(&accel_int))
	{
		LOG_ERR("GPIO dependency not ready");
		return -ENODEV;
	}

	ret = gpio_pin_configure_dt(&led, GPIO_OUTPUT_INACTIVE);
	ret |= gpio_pin_configure_dt(&magnet, GPIO_INPUT);
	ret |= gpio_pin_configure_dt(&accel_int, GPIO_INPUT);
	if (ret < 0)
	{
		LOG_ERR("GPIO configuration failed (%d)", ret);
		return ret;
	}

	ret = lis2dh12_zephyr_init(&lis2dh12);
	if (ret < 0)
	{
		LOG_ERR("LIS2DH12 init failed (%d)", ret);
		return ret;
	}

	ret = lis2dh12_zephyr_config_motion(&lis2dh12, MOTION_THRESHOLD_MG, MOTION_DURATION_SAMPLES);
	if (ret < 0)
	{
		LOG_ERR("LIS2DH12 motion config failed (%d)", ret);
		return ret;
	}

	gpio_init_callback(&accel_int_cb, accel_int_callback, BIT(accel_int.pin));
	ret = gpio_add_callback(accel_int.port, &accel_int_cb);
	ret |= gpio_pin_interrupt_configure_dt(&accel_int, GPIO_INT_EDGE_TO_ACTIVE);
	if (ret < 0)
	{
		LOG_ERR("INT1 callback setup failed (%d)", ret);
		return ret;
	}

	LOG_INF("AXY tester started: periodic=%dms, mode=SPI0, motion_ths=%u",
			SAMPLE_PERIOD_MS, MOTION_THRESHOLD_MG);

	while (1)
	{
		uint32_t period_motion;
		unsigned int irq_key = irq_lock();

		period_motion = motion_events;
		motion_events = 0U;
		irq_unlock(irq_key);

		int16_t x_mg = 0;
		int16_t y_mg = 0;
		int16_t z_mg = 0;
		struct lis2dh12_temp_diag temp_diag = {0};
		uint8_t int1_src = 0;
		int magnet_state = gpio_pin_get_dt(&magnet);

		if (magnet_state < 0)
		{
			if (!warned_magnet_fallback)
			{
				LOG_WRN("MAG_INT read failed (%d), using fallback", magnet_state);
				warned_magnet_fallback = true;
			}
			magnet_state = magnet_read_fallback();
		}

		ret = lis2dh12_zephyr_read_accel_mg(&lis2dh12, &x_mg, &y_mg, &z_mg);
		ret |= lis2dh12_zephyr_read_temp_diag(&lis2dh12, &temp_diag);
		ret |= lis2dh12_zephyr_read_int1_src(&lis2dh12, &int1_src);

		if (ret < 0)
		{
			LOG_ERR("Sample read failed (ret=%d) motion_1s=%u", ret, period_motion);
		}
		else
		{
			LOG_INF("AXY t=%u seq=%u motion_1s=%u x_mg=%d y_mg=%d z_mg=%d temp_c=%d mag=%d int1=0x%02x",
					k_uptime_get_32(), sample_seq, period_motion, x_mg, y_mg, z_mg,
					temp_diag.temp_c, magnet_state, int1_src);
			/* TEMP DIAG line — separate so the existing AXY line is
			 * unchanged and any external log parser keeps working.
			 * Healthy chip should show: whoami=0x33, temp_cfg=0xC0,
			 * ctrl1 ODR bits ≠ 0, status_aux bit2 (TDA) toggling 1,
			 * temp_h/temp_l moving with applied thermal load. */
			LOG_INF("TEMP_DIAG t=%u temp_h=0x%02x temp_l=0x%02x lsb=%d status_aux=0x%02x temp_cfg=0x%02x ctrl1=0x%02x ctrl4=0x%02x whoami=0x%02x",
					k_uptime_get_32(), temp_diag.temp_h, temp_diag.temp_l, temp_diag.lsb,
					temp_diag.status_aux, temp_diag.temp_cfg, temp_diag.ctrl_reg1,
					temp_diag.ctrl_reg4, temp_diag.whoami);
		}

		if (period_motion > 0U)
		{
			(void)gpio_pin_set_dt(&led, 1);
			k_sleep(K_MSEC(50));
			(void)gpio_pin_set_dt(&led, 0);
		}

		sample_seq++;
		k_sleep(K_MSEC(SAMPLE_PERIOD_MS));
	}

	return 0;
}
```

## src/lis2dh12_zephyr.c
```c
#include "lis2dh12_zephyr.h"

#include <errno.h>
#include <string.h>

#include <zephyr/kernel.h>
#include <zephyr/logging/log.h>

#include "lis2dh12_reg.h"

LOG_MODULE_REGISTER(lis2dh12_zephyr, LOG_LEVEL_INF);

#define LIS2DH12_NODE DT_ALIAS(spi_accel)
#define LIS2DH12_SPI_FREQ_HZ 8000000U

static struct lis2dh12_dev *g_dev;

static int32_t platform_read(void *handle, uint8_t reg, uint8_t *data, uint16_t len)
{
	ARG_UNUSED(handle);

	if (!g_dev || !g_dev->initialized) {
		return -ENODEV;
	}

	uint8_t tx_reg = reg | 0x80U;
	if (len > 1) {
		tx_reg |= 0x40U;
	}

	uint8_t tx_data[1 + 16] = {0};
	uint8_t rx_data[1 + 16] = {0};

	if (len > 16) {
		return -EINVAL;
	}

	tx_data[0] = tx_reg;

	const struct spi_buf tx_buf = {.buf = tx_data, .len = (size_t)(1 + len)};
	const struct spi_buf rx_buf = {.buf = rx_data, .len = (size_t)(1 + len)};
	const struct spi_buf_set tx = {.buffers = &tx_buf, .count = 1};
	const struct spi_buf_set rx = {.buffers = &rx_buf, .count = 1};

	int ret = spi_transceive(g_dev->spi_dev, &g_dev->spi_cfg, &tx, &rx);
	if (ret < 0) {
		LOG_ERR("SPI read failed reg=0x%02x ret=%d", reg, ret);
		return ret;
	}

	memcpy(data, &rx_data[1], len);
	return 0;
}

static int32_t platform_write(void *handle, uint8_t reg, const uint8_t *data, uint16_t len)
{
	ARG_UNUSED(handle);

	if (!g_dev || !g_dev->initialized) {
		return -ENODEV;
	}

	uint8_t tx_reg = reg & 0x7FU;
	if (len > 1) {
		tx_reg |= 0x40U;
	}

	uint8_t tx_data[1 + 16] = {0};
	if (len > 16) {
		return -EINVAL;
	}

	tx_data[0] = tx_reg;
	memcpy(&tx_data[1], data, len);

	const struct spi_buf tx_buf = {.buf = tx_data, .len = (size_t)(1 + len)};
	const struct spi_buf_set tx = {.buffers = &tx_buf, .count = 1};

	int ret = spi_write(g_dev->spi_dev, &g_dev->spi_cfg, &tx);
	if (ret < 0) {
		LOG_ERR("SPI write failed reg=0x%02x ret=%d", reg, ret);
		return ret;
	}

	return 0;
}

int lis2dh12_zephyr_read_whoami(struct lis2dh12_dev *dev, uint8_t *whoami)
{
	if (!dev || !dev->initialized || !whoami) {
		return -EINVAL;
	}

	return platform_read(NULL, LIS2DH12_WHO_AM_I, whoami, 1);
}

int lis2dh12_zephyr_init(struct lis2dh12_dev *dev)
{
	if (!dev) {
		return -EINVAL;
	}

	dev->spi_dev = DEVICE_DT_GET(DT_BUS(LIS2DH12_NODE));
	if (!device_is_ready(dev->spi_dev)) {
		LOG_ERR("LIS2DH12 SPI not ready");
		return -ENODEV;
	}

	dev->spi_cs.gpio = (struct gpio_dt_spec)SPI_CS_GPIOS_DT_SPEC_GET(LIS2DH12_NODE);
	dev->spi_cs.delay = 0U;

	if (!gpio_is_ready_dt(&dev->spi_cs.gpio)) {
		LOG_ERR("LIS2DH12 CS GPIO not ready");
		return -ENODEV;
	}

	dev->spi_cfg.frequency = LIS2DH12_SPI_FREQ_HZ;
	dev->spi_cfg.operation = SPI_WORD_SET(8) | SPI_TRANSFER_MSB; /* Mode 0 */
	dev->spi_cfg.slave = DT_REG_ADDR(LIS2DH12_NODE);
	dev->spi_cfg.cs = dev->spi_cs;

	dev->initialized = true;
	g_dev = dev;

	uint8_t whoami = 0;
	int ret = lis2dh12_zephyr_read_whoami(dev, &whoami);
	if (ret < 0) {
		return ret;
	}
	if (whoami != 0x33) {
		LOG_ERR("Unexpected WHO_AM_I=0x%02x", whoami);
		return -ENODEV;
	}

	uint8_t ctrl_reg1 = 0x2F; /* 10Hz, LP mode, XYZ on */
	uint8_t ctrl_reg4 = 0x80; /* BDU on, +-2g */
	uint8_t temp_cfg = 0xC0;  /* temperature enabled */

	ret = platform_write(NULL, 0x20, &ctrl_reg1, 1);
	ret |= platform_write(NULL, 0x23, &ctrl_reg4, 1);
	ret |= platform_write(NULL, 0x1F, &temp_cfg, 1);
	if (ret < 0) {
		LOG_ERR("Failed LIS2DH12 base config");
		return ret;
	}

	k_sleep(K_MSEC(50));
	LOG_INF("LIS2DH12 ready WHO_AM_I=0x%02x SPI=Mode0", whoami);
	return 0;
}

int lis2dh12_zephyr_read_accel_mg(struct lis2dh12_dev *dev, int16_t *x_mg, int16_t *y_mg, int16_t *z_mg)
{
	if (!dev || !dev->initialized || !x_mg || !y_mg || !z_mg) {
		return -EINVAL;
	}

	uint8_t raw[6] = {0};
	int ret = platform_read(NULL, 0x28, raw, 6);
	if (ret < 0) {
		return ret;
	}

	*x_mg = (int16_t)((raw[1] << 8) | raw[0]);
	*y_mg = (int16_t)((raw[3] << 8) | raw[2]);
	*z_mg = (int16_t)((raw[5] << 8) | raw[4]);
	return 0;
}

int lis2dh12_zephyr_read_temp_c(struct lis2dh12_dev *dev, int8_t *temp_c)
{
	if (!dev || !dev->initialized || !temp_c) {
		return -EINVAL;
	}

	/* Single multi-byte SPI transaction across OUT_TEMP_L (0x0C) and
	 * OUT_TEMP_H (0x0D) inside one CS-low window.  platform_read sets
	 * the MS auto-increment bit when len>1, so the chip returns both
	 * bytes from the same sample regardless of BDU state — this is the
	 * datasheet-recommended burst-read pattern and avoids any chance of
	 * mixing L from sample N with H from sample N+1. */
	uint8_t temp_lh[2] = {0};
	int ret = platform_read(NULL, 0x0C, temp_lh, 2);
	if (ret < 0) {
		return ret;
	}

	int16_t lsb = (int16_t)(((uint16_t)temp_lh[1] << 8) | temp_lh[0]);
	*temp_c = (int8_t)lis2dh12_from_lsb_lp_to_celsius(lsb);
	return 0;
}

int lis2dh12_zephyr_read_temp_diag(struct lis2dh12_dev *dev,
				   struct lis2dh12_temp_diag *out)
{
	if (!dev || !dev->initialized || !out) {
		return -EINVAL;
	}

	memset(out, 0, sizeof(*out));

	/* Single multi-byte SPI transaction across OUT_TEMP_L (0x0C) and
	 * OUT_TEMP_H (0x0D).  platform_read sets the MS (auto-increment) bit
	 * when len>1, so this is one CS-low window covering both bytes —
	 * datasheet-recommended pattern, also bypasses any BDU torn-read
	 * concern. */
	uint8_t temp_lh[2] = {0};
	int ret = platform_read(NULL, 0x0C, temp_lh, 2);
	if (ret < 0) {
		return ret;
	}
	out->temp_l = temp_lh[0];
	out->temp_h = temp_lh[1];
	out->lsb = (int16_t)(((uint16_t)out->temp_h << 8) | out->temp_l);
	out->temp_c = (int8_t)lis2dh12_from_lsb_lp_to_celsius(out->lsb);

	/* Aux/config register readbacks.  Single-byte reads — order chosen to
	 * surface the most diagnostic information first if any read fails. */
	ret |= platform_read(NULL, 0x07, &out->status_aux, 1);  /* STATUS_REG_AUX */
	ret |= platform_read(NULL, 0x1F, &out->temp_cfg, 1);    /* TEMP_CFG_REG */
	ret |= platform_read(NULL, 0x20, &out->ctrl_reg1, 1);   /* CTRL_REG1 */
	ret |= platform_read(NULL, 0x23, &out->ctrl_reg4, 1);   /* CTRL_REG4 */
	ret |= platform_read(NULL, 0x0F, &out->whoami, 1);      /* WHO_AM_I */

	return (ret < 0) ? ret : 0;
}

int lis2dh12_zephyr_config_motion(struct lis2dh12_dev *dev, uint8_t threshold, uint8_t duration)
{
	if (!dev || !dev->initialized) {
		return -EINVAL;
	}

	uint8_t ctrl1 = 0x57;   /* 100Hz XYZ on */
	uint8_t ctrl2 = 0x09;   /* HP filter on INT1 */
	uint8_t ctrl3 = 0x40;   /* route activity interrupt to INT1 */
	uint8_t ctrl4 = 0x80;   /* BDU on, +-2g (BDU required for aux temp ADC updates) */
	uint8_t ctrl5 = 0x00;   /* non-latched INT1 */
	uint8_t int1_cfg = 0x2A;/* XH/YH/ZH OR */
	uint8_t reference = 0;
	uint8_t int1_src = 0;

	int ret = 0;
	ret |= platform_write(NULL, 0x20, &ctrl1, 1);
	ret |= platform_write(NULL, 0x21, &ctrl2, 1);
	ret |= platform_write(NULL, 0x22, &ctrl3, 1);
	ret |= platform_write(NULL, 0x23, &ctrl4, 1);
	ret |= platform_write(NULL, 0x24, &ctrl5, 1);
	ret |= platform_write(NULL, 0x32, &threshold, 1);
	ret |= platform_write(NULL, 0x33, &duration, 1);
	ret |= platform_read(NULL, 0x26, &reference, 1);
	ret |= platform_write(NULL, 0x30, &int1_cfg, 1);
	ret |= platform_read(NULL, 0x31, &int1_src, 1);
	if (ret < 0) {
		LOG_ERR("Failed motion setup");
		return ret;
	}

	/* Re-arm the aux temperature ADC against the accel mode/ODR we just
	 * programmed above.  The aux ADC's scheduling is tied to CTRL_REG1's
	 * operating mode + ODR; if temp was enabled by lis2dh12_zephyr_init()
	 * while the chip was still in its initial config, the OUT_TEMP_L/H
	 * registers can latch a single sample and never refresh after this
	 * mode change.  Disable-then-enable forces a clean restart of the
	 * temperature conversion path. */
	uint8_t temp_cfg_off = 0x00;
	uint8_t temp_cfg_on = 0xC0;
	ret |= platform_write(NULL, 0x1F, &temp_cfg_off, 1);
	ret |= platform_write(NULL, 0x1F, &temp_cfg_on, 1);
	if (ret < 0) {
		LOG_ERR("Failed temp sensor re-arm");
		return ret;
	}

	LOG_INF("LIS2DH12 motion configured threshold=%u duration=%u", threshold, duration);
	return 0;
}

int lis2dh12_zephyr_power_down(struct lis2dh12_dev *dev)
{
	if (!dev || !dev->initialized) {
		return -EINVAL;
	}

	uint8_t ctrl1 = 0;
	int ret = platform_read(NULL, 0x20, &ctrl1, 1);
	if (ret < 0) {
		return ret;
	}

	ctrl1 &= 0x0FU; /* ODR[3:0] = 0000: power-down mode. */
	ret = platform_write(NULL, 0x20, &ctrl1, 1);
	if (ret < 0) {
		LOG_ERR("Failed LIS2DH12 power-down");
		return ret;
	}

	LOG_INF("LIS2DH12 powered down");
	return 0;
}

int lis2dh12_zephyr_read_int1_src(struct lis2dh12_dev *dev, uint8_t *int1_src)
{
	if (!dev || !dev->initialized || !int1_src) {
		return -EINVAL;
	}

	return platform_read(NULL, 0x31, int1_src, 1);
}
```

## src/lis2dh12_zephyr.h
```c
#ifndef JUXTA5_8_LIS2DH12_ZEPHYR_H
#define JUXTA5_8_LIS2DH12_ZEPHYR_H

#include <stdint.h>
#include <zephyr/drivers/gpio.h>
#include <zephyr/drivers/spi.h>

struct lis2dh12_dev {
	const struct device *spi_dev;
	struct spi_config spi_cfg;
	struct spi_cs_control spi_cs;
	bool initialized;
};

/* Bundle of raw bytes useful for diagnosing why the temperature sensor
 * appears to be returning a fixed value.  Each field is the raw chip
 * register read; `temp_c` is the converted value using the same ST helper
 * as `lis2dh12_zephyr_read_temp_c`.  See lis2dh12_zephyr_read_temp_diag(). */
struct lis2dh12_temp_diag {
	int8_t temp_c;       /* same conversion as read_temp_c */
	int16_t lsb;         /* assembled (temp_h << 8) | temp_l */
	uint8_t temp_h;      /* OUT_TEMP_H  (0x0D) */
	uint8_t temp_l;      /* OUT_TEMP_L  (0x0C) */
	uint8_t status_aux;  /* STATUS_REG_AUX (0x07): bit2=TDA, bit6=TOR */
	uint8_t temp_cfg;    /* TEMP_CFG_REG   (0x1F): bits7:6 must be 11 to enable */
	uint8_t ctrl_reg1;   /* CTRL_REG1      (0x20): ODR[7:4], LPen[3], Zen Yen Xen */
	uint8_t ctrl_reg4;   /* CTRL_REG4      (0x23): BDU[7] must be 1 for safe L+H reads */
	uint8_t whoami;      /* WHO_AM_I       (0x0F): must be 0x33; SPI sanity check */
};

int lis2dh12_zephyr_init(struct lis2dh12_dev *dev);
int lis2dh12_zephyr_read_whoami(struct lis2dh12_dev *dev, uint8_t *whoami);
int lis2dh12_zephyr_read_accel_mg(struct lis2dh12_dev *dev, int16_t *x_mg, int16_t *y_mg, int16_t *z_mg);
int lis2dh12_zephyr_read_temp_c(struct lis2dh12_dev *dev, int8_t *temp_c);
/* Diagnostic read: fetches OUT_TEMP_L+OUT_TEMP_H in a single multi-byte SPI
 * transaction (datasheet-recommended pattern, avoids any BDU torn-read
 * concern) and also reads STATUS_REG_AUX, TEMP_CFG_REG, CTRL_REG1, CTRL_REG4,
 * and WHO_AM_I so the caller can decide whether the sensor is enabled, is
 * producing fresh data, and whether the SPI bus is healthy. */
int lis2dh12_zephyr_read_temp_diag(struct lis2dh12_dev *dev,
				   struct lis2dh12_temp_diag *out);
int lis2dh12_zephyr_config_motion(struct lis2dh12_dev *dev, uint8_t threshold, uint8_t duration);
int lis2dh12_zephyr_power_down(struct lis2dh12_dev *dev);
int lis2dh12_zephyr_read_int1_src(struct lis2dh12_dev *dev, uint8_t *int1_src);

#endif
```
