## CMakeLists.txt
```
cmake_minimum_required(VERSION 3.20.0)

find_package(Zephyr REQUIRED HINTS $ENV{ZEPHYR_BASE})
project(juxta5_8_prod LANGUAGES C)

target_include_directories(app PRIVATE
    ${CMAKE_CURRENT_SOURCE_DIR}/src
    ${CMAKE_CURRENT_SOURCE_DIR}/../juxta5-8-axy/src
    ${CMAKE_CURRENT_SOURCE_DIR}/../../Reference/nRF/lib/lisd2h12
)

target_sources(app PRIVATE
    src/main.c
    src/ble_service.c
    src/juxta_checkpoint.c
    src/juxta_log.c
    src/juxta_pof.c
    src/juxta_settings.c
    src/juxta_time.c
    ${CMAKE_CURRENT_SOURCE_DIR}/../juxta5-8-axy/src/lis2dh12_zephyr.c
    ${CMAKE_CURRENT_SOURCE_DIR}/../../Reference/nRF/lib/lisd2h12/lis2dh12_reg.c
)
```

## prj.conf
```kconfig
# Juxta5-8 production firmware: Hublink BLE + NOR CSV logging

CONFIG_GPIO=y
CONFIG_ADC=y

# SAADC gates analog front-end via runtime PM inside each adc_read.
CONFIG_PM_DEVICE=y
CONFIG_PM_DEVICE_RUNTIME=y

CONFIG_SPI=y
CONFIG_SPI_NRFX=y
CONFIG_FLASH=y
CONFIG_FLASH_PAGE_LAYOUT=y
CONFIG_SPI_NOR=y
CONFIG_SPI_NOR_SFDP_RUNTIME=y

# Internal nRF52840 flash settings store.
# 4 sectors × 4 KB = 16 KB of the 64 KB storage_partition.  The log-cache
# struct grew with JUXTA_MAX_FILES=48 (~1.5 KB per write) and is rewritten
# ~3×/day at calendar rotation, so 4 sectors give NVS comfortable GC margin
# over a 12-day deployment while staying well under the 10 k internal-flash
# erase budget.
CONFIG_SETTINGS=y
CONFIG_SETTINGS_NVS=y
CONFIG_SETTINGS_NVS_SECTOR_COUNT=4
CONFIG_NVS=y
CONFIG_FLASH_MAP=y
CONFIG_MPU_ALLOW_FLASH_WRITE=y

# GATT client role required for bt_gatt_exchange_mtu() (MTU negotiation).
CONFIG_BT_GATT_CLIENT=y

# Bluetooth Hublink peripheral + observer.
CONFIG_BT=y
CONFIG_BT_OBSERVER=y
CONFIG_BT_PERIPHERAL=y
CONFIG_BT_DEVICE_NAME="JX_CONNECT"
CONFIG_BT_DEVICE_NAME_DYNAMIC=y
# Advertise peripheral preferred connection parameters in the GATT GAP service
# so iOS can read our preferences before the explicit update request.
CONFIG_BT_GAP_PERIPHERAL_PREF_PARAMS=y
CONFIG_BT_PERIPHERAL_PREF_MIN_INT=24
CONFIG_BT_PERIPHERAL_PREF_MAX_INT=40
CONFIG_BT_PERIPHERAL_PREF_LATENCY=0
CONFIG_BT_PERIPHERAL_PREF_TIMEOUT=400
CONFIG_BT_MAX_CONN=1
CONFIG_BT_HCI_ERR_TO_STR=y

# Match legacy juxta-ble transfer envelope.
CONFIG_BT_L2CAP_TX_MTU=247
CONFIG_BT_BUF_ACL_RX_SIZE=251
CONFIG_BT_BUF_ACL_TX_SIZE=251
CONFIG_BT_SMP=n
CONFIG_BT_SIGNING=n
CONFIG_BT_ATT_PREPARE_COUNT=0
CONFIG_BT_PRIVACY=n
CONFIG_BT_SETTINGS=n
CONFIG_BT_BUF_EVT_RX_COUNT=2
CONFIG_BT_BUF_EVT_DISCARDABLE_COUNT=2

# MCUboot image upload over mcumgr SMP BLE (DFU mode after long magnet hold).
CONFIG_NET_BUF=y
CONFIG_ZCBOR=y
CONFIG_CRC=y
CONFIG_STREAM_FLASH=y
CONFIG_IMG_MANAGER=y
CONFIG_MCUMGR=y
CONFIG_MCUMGR_GRP_IMG=y
CONFIG_MCUMGR_GRP_OS=y
CONFIG_MCUMGR_TRANSPORT_BT=y
CONFIG_MCUMGR_TRANSPORT_BT_DYNAMIC_SVC_REGISTRATION=y
CONFIG_MCUMGR_TRANSPORT_BT_REASSEMBLY=y
CONFIG_MCUMGR_TRANSPORT_NETBUF_SIZE=1024
CONFIG_MCUMGR_TRANSPORT_WORKQUEUE_STACK_SIZE=4096

# Logging over RTT.
CONFIG_LOG=y
CONFIG_LOG_DEFAULT_LEVEL=3
CONFIG_USE_SEGGER_RTT=y
CONFIG_RTT_CONSOLE=y
CONFIG_CONSOLE=y
CONFIG_LOG_BACKEND_RTT=y
# Production logging profile: drop log entries when the RTT FIFO fills
# instead of blocking the caller.  BLOCK_IF_FIFO_FULL is fine on the bench
# with a J-Link draining RTT, but in the field with no host attached the
# first burst of logs (file offload, NOR erase) fills the FIFO and stalls
# the logging thread — and under CONFIG_LOG_MODE_IMMEDIATE the *caller*
# (BT RX, system workqueue) — forever, producing the "device goes quiet"
# silent-hang symptom.  NO_BLOCK_SKIP makes that impossible.
CONFIG_SEGGER_RTT_MODE_NO_BLOCK_SKIP=y
CONFIG_UART_CONSOLE=n

# DIAGNOSTIC BUILD: synchronous (immediate) logging.
# Each LOG_*() call writes directly to RTT instead of being queued in the
# deferred ring buffer for the logging thread to drain.  This eliminates the
# "N messages dropped" lines that appear under burst load (scan flush, vitals
# flash_append loop) and *guarantees* that the last log line emitted before
# any hang or watchdog reset reaches RTT — which is the whole point of this
# diagnostic build.  Trade-off: LOG_* calls block the caller on RTT for the
# duration of each write (a few hundred microseconds per line), so hot paths
# get slightly slower.  Acceptable given the 5 s WDT window.  Revert to
# deferred mode (remove this line) once the silent-hang root cause is found.
CONFIG_LOG_MODE_IMMEDIATE=y

CONFIG_MAIN_STACK_SIZE=16384
CONFIG_SYSTEM_WORKQUEUE_STACK_SIZE=8192
CONFIG_ISR_STACK_SIZE=2048
# BT RX WQ runs every GATT write callback inline (apply_gateway_command,
# write_filename_char, etc.).  The deepest sync-gate call chain
# (sscanf-based JSON parsing + file listing/transfer) measured 3368 / 4096
# bytes = 82 % at the end of wait_for_datetime_sync — right at the README
# diagnostics "investigate" threshold.  Bumped to 6144 to keep peak usage
# below 60 % so future code-path growth (or a deeper transient call chain)
# does not cause a stack overrun under field load.  Costs +2 KB RAM.
CONFIG_BT_RX_STACK_SIZE=6144
CONFIG_BT_HCI_TX_STACK_SIZE=1536
CONFIG_HEAP_MEM_POOL_SIZE=8192

# P0.09 is NFC; use as GPIO for LED0.
CONFIG_NFCT_PINS_AS_GPIOS=y

# sys_poweroff() for shelf mode (nRF52840 System OFF, magnet GPIO wake).
CONFIG_POWEROFF=y
# sys_reboot() for debug simulation loop (shelf mode emulation with J-Link).
CONFIG_REBOOT=y

# Watchdog and production reliability.
CONFIG_WATCHDOG=y
CONFIG_WDT_NRFX=y

# POFCON supply-droop witness (src/juxta_pof.c).  The nrfx POWER driver
# provides nrfx_power_pof_init/enable; its IRQ shares the POWER_CLOCK vector
# already connected by the clock driver (nrfx_power_clock_irq_handler
# dispatches to both nrfx_power and the MPSL clock handler).
CONFIG_NRFX_POWER=y

CONFIG_NEWLIB_LIBC=y
CONFIG_NEWLIB_LIBC_FLOAT_PRINTF=y
CONFIG_NEWLIB_LIBC_FLOAT_SCANF=y
CONFIG_DEBUG_THREAD_INFO=y
CONFIG_ASSERT=y
CONFIG_THREAD_STACK_INFO=y
CONFIG_HW_STACK_PROTECTION=y
CONFIG_STACK_SENTINEL=y
CONFIG_FAULT_DUMP=2

# Diagnostic: per-thread stack high-water marks logged via RTT every vitals
# tick (60 s default).  Pre-fills stacks with 0xAA so the analyzer can compute
# how much of each stack has ever been touched.  Drive thread_analyzer_print()
# manually from vitals_work_handler — no AUTO thread, so no extra RAM cost.
CONFIG_THREAD_ANALYZER=y
CONFIG_THREAD_ANALYZER_USE_LOG=y
CONFIG_INIT_STACKS=y
CONFIG_THREAD_NAME=y
CONFIG_THREAD_RUNTIME_STATS=y
CONFIG_THREAD_RUNTIME_STATS_USE_TIMING_FUNCTIONS=y
```

## src/ble_service.h
```c
#ifndef JUXTA_BLE_SERVICE_H_
#define JUXTA_BLE_SERVICE_H_

#include <stdbool.h>
#include <stdint.h>

#include <zephyr/bluetooth/conn.h>
#include <zephyr/bluetooth/uuid.h>

#include "juxta_log.h"

#define JUXTA_HUBLINK_SERVICE_UUID                                                                  \
	0xFB, 0x34, 0x9B, 0x5F, 0x80, 0x00, 0x00, 0x80, 0x01, 0x00, 0x01, 0x55, 0x68, 0x73,       \
		0x61, 0x57
#define JUXTA_NODE_CHAR_UUID                                                                        \
	0xFB, 0x34, 0x9B, 0x5F, 0x80, 0x00, 0x00, 0x80, 0x01, 0x00, 0x05, 0x55, 0x68, 0x73,       \
		0x61, 0x57
#define JUXTA_GATEWAY_CHAR_UUID                                                                     \
	0xFB, 0x34, 0x9B, 0x5F, 0x80, 0x00, 0x00, 0x80, 0x01, 0x00, 0x04, 0x55, 0x68, 0x73,       \
		0x61, 0x57
#define JUXTA_FILENAME_CHAR_UUID                                                                    \
	0xFB, 0x34, 0x9B, 0x5F, 0x80, 0x00, 0x00, 0x80, 0x01, 0x00, 0x02, 0x55, 0x68, 0x73,       \
		0x61, 0x57
#define JUXTA_FILE_TRANSFER_CHAR_UUID                                                               \
	0xFB, 0x34, 0x9B, 0x5F, 0x80, 0x00, 0x00, 0x80, 0x01, 0x00, 0x03, 0x55, 0x68, 0x73,       \
		0x61, 0x57

#define BT_UUID_JUXTA_HUBLINK_SERVICE BT_UUID_DECLARE_128(JUXTA_HUBLINK_SERVICE_UUID)
#define BT_UUID_JUXTA_NODE_CHAR BT_UUID_DECLARE_128(JUXTA_NODE_CHAR_UUID)
#define BT_UUID_JUXTA_GATEWAY_CHAR BT_UUID_DECLARE_128(JUXTA_GATEWAY_CHAR_UUID)
#define BT_UUID_JUXTA_FILENAME_CHAR BT_UUID_DECLARE_128(JUXTA_FILENAME_CHAR_UUID)
#define BT_UUID_JUXTA_FILE_TRANSFER_CHAR BT_UUID_DECLARE_128(JUXTA_FILE_TRANSFER_CHAR_UUID)

int juxta_ble_service_init(struct juxta_log_context *log_ctx);
int juxta_ble_get_device_id(char *device_id);
void juxta_ble_connection_established(struct bt_conn *conn);
void juxta_ble_connection_terminated(void);
int juxta_ble_get_status(uint16_t *mtu, bool *connected, bool *transfer_active);

/* Set a getter that returns current battery voltage in millivolts.
 * Called once from main() before advertising starts. */
void juxta_ble_set_battery_mv_source(int32_t (*getter)(void));
void juxta_ble_set_production_ready(void);

void juxta_ble_timing_update_trigger(void);
void juxta_ble_datetime_synchronized(void);
void juxta_ble_reset_requested(void);
/* Called from the BT RX thread when a gateway `clearMemory` command arrives.
 * The implementation must defer the actual NOR erase off the BT RX thread so
 * the GATT write callback returns promptly (the erase is many seconds long;
 * doing it inline blows past the BLE supervision timeout and stalls every
 * other consumer of the BT RX queue). */
void juxta_ble_clear_memory_requested(void);

#endif /* JUXTA_BLE_SERVICE_H_ */
```

## src/juxta_checkpoint.c
```c
#include "juxta_checkpoint.h"

#include <errno.h>
#include <stddef.h>
#include <string.h>

#include <zephyr/device.h>
#include <zephyr/devicetree.h>
#include <zephyr/drivers/flash.h>
#include <zephyr/kernel.h>
#include <zephyr/logging/log.h>
#include <zephyr/sys/crc.h>
#include <zephyr/sys/util.h>

LOG_MODULE_REGISTER(juxta_checkpoint, LOG_LEVEL_INF);

#define FLASH_NODE DT_ALIAS(spi_mem)

/* Ring geometry.  RING_START must match the space carved from the tail of
 * JXB in juxta_log.c (JXB_SIZE shrunk 0x2F0000 -> 0x2E0000); the two
 * modules never overlap and neither touches the other's region. */
#define RING_START 0x3F0000U
#define RING_SIZE 0x010000U
#define SECTOR_SIZE 0x1000U
#define SLOT_SIZE 32U

#define SLOTS_PER_SECTOR (SECTOR_SIZE / SLOT_SIZE) /* 128 */
#define TOTAL_SLOTS (RING_SIZE / SLOT_SIZE)		   /* 2048 */
#define SECTOR_COUNT (RING_SIZE / SECTOR_SIZE)	   /* 16 */

#define SLOT_MAGIC 0x4A58434BU /* 'JXCK' */
#define SLOT_VERSION 1U

/* On-flash record.  CRC32 covers everything before the crc32 field.
 * Erased flash (all 0xFF) naturally fails the magic + CRC check. */
struct checkpoint_slot
{
	uint32_t magic;
	uint32_t seq; /* monotonic across the whole ring; newest wins */
	uint32_t unix_time;
	uint32_t motion_count;
	int32_t batt_mv;
	int8_t temp_c;
	uint8_t version;
	uint8_t flags; /* reserved, 0 */
	uint8_t _pad;
	uint32_t reserved; /* future use, 0 */
	uint32_t crc32;
};

BUILD_ASSERT(sizeof(struct checkpoint_slot) == SLOT_SIZE,
			 "checkpoint slot must be exactly one ring slot");

static const struct device *const s_flash = DEVICE_DT_GET(FLASH_NODE);

/* Serializes head/seq mutations and multi-step flash sequences between the
 * 1 Hz checkpoint work item (sysworkq), the clearMemory work item (also
 * sysworkq) and enter_shelf_mode() on the main thread. */
static K_MUTEX_DEFINE(s_lock);

static bool s_scanned;	/* head/seq/newest are valid */
static bool s_disabled; /* writes no-op (shelf teardown) */
static uint32_t s_head; /* next slot index to write, 0..TOTAL_SLOTS-1 */
static uint32_t s_next_seq;
static struct juxta_checkpoint_record s_newest;
static bool s_newest_valid;

static uint32_t slot_offset(uint32_t slot)
{
	return RING_START + slot * SLOT_SIZE;
}

static uint32_t slot_crc(const struct checkpoint_slot *slot)
{
	return crc32_ieee((const uint8_t *)slot, offsetof(struct checkpoint_slot, crc32));
}

static bool slot_valid(const struct checkpoint_slot *slot)
{
	return slot->magic == SLOT_MAGIC && slot->version == SLOT_VERSION &&
		   slot->unix_time != 0U && slot->crc32 == slot_crc(slot);
}

static int erase_sector_at(uint32_t offset)
{
	int rc = flash_erase(s_flash, offset & ~(SECTOR_SIZE - 1U), SECTOR_SIZE);

	if (rc != 0)
	{
		LOG_ERR("sector erase @0x%06x failed: %d", (unsigned int)offset, rc);
	}
	return rc;
}

/* Scan the whole ring: remember the newest valid record (highest seq) and
 * park the write head on the slot after it.  If the remainder of the head's
 * sector is not erased (stale data from a previous wrap), advance the head
 * to the next sector boundary — the on-entry erase in write() handles the
 * rest.  Must be called with s_lock held. */
static int scan_ring_locked(void)
{
	static uint8_t buf[512]; /* 16 slots per read, 128 reads total */
	struct checkpoint_slot slot;
	uint32_t best_seq = 0U;
	uint32_t best_slot = UINT32_MAX;
	struct juxta_checkpoint_record best = {0};

	if (!device_is_ready(s_flash))
	{
		return -ENODEV;
	}

	for (uint32_t off = 0U; off < RING_SIZE; off += sizeof(buf))
	{
		int rc = flash_read(s_flash, RING_START + off, buf, sizeof(buf));

		if (rc != 0)
		{
			LOG_ERR("scan read @0x%06x failed: %d", (unsigned int)(RING_START + off), rc);
			return rc;
		}

		for (uint32_t i = 0U; i < sizeof(buf); i += SLOT_SIZE)
		{
			memcpy(&slot, &buf[i], sizeof(slot));
			if (slot_valid(&slot) && slot.seq >= best_seq)
			{
				best_seq = slot.seq;
				best_slot = (off + i) / SLOT_SIZE;
				best.unix_time = slot.unix_time;
				best.motion_count = slot.motion_count;
				best.batt_mv = slot.batt_mv;
				best.temp_c = slot.temp_c;
			}
		}
	}

	if (best_slot == UINT32_MAX)
	{
		s_head = 0U;
		s_next_seq = 1U;
		s_newest_valid = false;
		s_scanned = true;
		LOG_INF("ring empty — head at slot 0");
		return 0;
	}

	s_newest = best;
	s_newest_valid = true;
	s_next_seq = best_seq + 1U;
	s_head = (best_slot + 1U) % TOTAL_SLOTS;

	/* Stale-tail check: programming over non-erased bytes would corrupt
	 * every record until the next sector boundary.  If any byte between
	 * the head and its sector end is not 0xFF, skip to the next sector
	 * (loses nothing newer than the oldest records). */
	if ((s_head % SLOTS_PER_SECTOR) != 0U)
	{
		uint32_t sector_end_slot = ((s_head / SLOTS_PER_SECTOR) + 1U) * SLOTS_PER_SECTOR;
		bool tail_erased = true;

		for (uint32_t slot_idx = s_head; slot_idx < sector_end_slot && tail_erased;
			 slot_idx += sizeof(buf) / SLOT_SIZE)
		{
			uint32_t count = MIN(sizeof(buf) / SLOT_SIZE, sector_end_slot - slot_idx);
			int rc = flash_read(s_flash, slot_offset(slot_idx), buf, count * SLOT_SIZE);

			if (rc != 0)
			{
				return rc;
			}
			for (uint32_t b = 0U; b < count * SLOT_SIZE; b++)
			{
				if (buf[b] != 0xFFU)
				{
					tail_erased = false;
					break;
				}
			}
		}

		if (!tail_erased)
		{
			s_head = sector_end_slot % TOTAL_SLOTS;
		}
	}

	s_scanned = true;
	LOG_INF("newest seq=%u unix=%u — head at slot %u", best_seq, best.unix_time, s_head);
	return 0;
}

static int ensure_scanned_locked(void)
{
	if (s_scanned)
	{
		return 0;
	}
	return scan_ring_locked();
}

int juxta_checkpoint_init(void)
{
	k_mutex_lock(&s_lock, K_FOREVER);
	int rc = ensure_scanned_locked();

	k_mutex_unlock(&s_lock);
	return rc;
}

int juxta_checkpoint_load(struct juxta_checkpoint_record *out)
{
	if (!out)
	{
		return -EINVAL;
	}

	k_mutex_lock(&s_lock, K_FOREVER);
	int rc = ensure_scanned_locked();

	if (rc == 0)
	{
		if (s_newest_valid)
		{
			*out = s_newest;
		}
		else
		{
			rc = -ENOENT;
		}
	}
	k_mutex_unlock(&s_lock);
	return rc;
}

int juxta_checkpoint_write(const struct juxta_checkpoint_record *rec)
{
	struct checkpoint_slot slot;
	int rc;

	if (!rec || rec->unix_time == 0U)
	{
		return -EINVAL;
	}

	k_mutex_lock(&s_lock, K_FOREVER);

	if (s_disabled)
	{
		k_mutex_unlock(&s_lock);
		return 0;
	}

	rc = ensure_scanned_locked();
	if (rc != 0)
	{
		k_mutex_unlock(&s_lock);
		return rc;
	}

	/* On-entry erase: the sector the head is entering holds only the
	 * oldest ~2 minutes of records.  ~45 ms once every 128 writes on the
	 * system workqueue — well under the 2 s WDT feed cadence. */
	if ((s_head % SLOTS_PER_SECTOR) == 0U)
	{
		rc = erase_sector_at(slot_offset(s_head));
		if (rc != 0)
		{
			k_mutex_unlock(&s_lock);
			return rc;
		}
	}

	memset(&slot, 0, sizeof(slot));
	slot.magic = SLOT_MAGIC;
	slot.seq = s_next_seq;
	slot.unix_time = rec->unix_time;
	slot.motion_count = rec->motion_count;
	slot.batt_mv = rec->batt_mv;
	slot.temp_c = rec->temp_c;
	slot.version = SLOT_VERSION;
	slot.crc32 = slot_crc(&slot);

	rc = flash_write(s_flash, slot_offset(s_head), &slot, sizeof(slot));
	if (rc != 0)
	{
		LOG_ERR("slot write @%u failed: %d", s_head, rc);
		/* Skip the (possibly half-programmed) slot so the next write
		 * cannot land on dirty bytes. */
		s_head = (s_head + 1U) % TOTAL_SLOTS;
		k_mutex_unlock(&s_lock);
		return rc;
	}

	s_newest.unix_time = rec->unix_time;
	s_newest.motion_count = rec->motion_count;
	s_newest.batt_mv = rec->batt_mv;
	s_newest.temp_c = rec->temp_c;
	s_newest_valid = true;
	s_next_seq++;
	s_head = (s_head + 1U) % TOTAL_SLOTS;

	k_mutex_unlock(&s_lock);
	return 0;
}

/* Erase every non-blank sector of the ring and restart at slot 0.  The
 * already-erased check keeps repeat resets (activation after a shelf-entry
 * erase) nearly free.  Must be called with s_lock held. */
static int erase_ring_locked(void)
{
	static uint8_t buf[512];

	if (!device_is_ready(s_flash))
	{
		return -ENODEV;
	}

	for (uint32_t sector = 0U; sector < SECTOR_COUNT; sector++)
	{
		uint32_t base = RING_START + sector * SECTOR_SIZE;
		bool blank = true;

		for (uint32_t off = 0U; off < SECTOR_SIZE && blank; off += sizeof(buf))
		{
			int rc = flash_read(s_flash, base + off, buf, sizeof(buf));

			if (rc != 0)
			{
				return rc;
			}
			for (uint32_t b = 0U; b < sizeof(buf); b++)
			{
				if (buf[b] != 0xFFU)
				{
					blank = false;
					break;
				}
			}
		}

		if (!blank)
		{
			int rc = erase_sector_at(base);

			if (rc != 0)
			{
				return rc;
			}
		}
	}

	s_head = 0U;
	s_next_seq = 1U;
	s_newest_valid = false;
	s_scanned = true;
	return 0;
}

int juxta_checkpoint_reset(void)
{
	k_mutex_lock(&s_lock, K_FOREVER);
	int rc = erase_ring_locked();

	if (rc == 0)
	{
		s_disabled = false;
		LOG_INF("ring reset — checkpointing enabled");
	}
	k_mutex_unlock(&s_lock);
	return rc;
}

void juxta_checkpoint_disable(void)
{
	k_mutex_lock(&s_lock, K_FOREVER);
	s_disabled = true;
	k_mutex_unlock(&s_lock);
}

int juxta_checkpoint_erase(void)
{
	k_mutex_lock(&s_lock, K_FOREVER);
	int rc = erase_ring_locked();

	k_mutex_unlock(&s_lock);
	return rc;
}
```

## src/juxta_checkpoint.h
```c
/*
 * Juxta5-8 production checkpoint ring ("draft vitals")
 *
 * A 64 KB ring buffer at the tail of the external NOR (carved from JXB)
 * that persists a small clock + vitals snapshot once per second while
 * production runs.  Unlike the retained-RAM RTC snapshot in juxta_time.c
 * (which only survives soft resets), this ring survives a true power-on
 * reset — it is what lets a mid-session POR resume production instead of
 * silently shelving (fw 5.8.4 "POR production resume").
 *
 * Geometry: 16 × 4 KB sectors, 32 B records → 2048 slots (~34 min of
 * history at 1 Hz).  Each sector is erased as the write head enters it,
 * so the newest ~15 sectors of records are always intact.  Endurance:
 * ~42 sector erases/day → years at typical 100k NOR P/E cycles.  A torn
 * record from a dying supply simply fails CRC; the previous record wins.
 *
 * SPDX-License-Identifier: Apache-2.0
 */

#ifndef JUXTA_CHECKPOINT_H_
#define JUXTA_CHECKPOINT_H_

#include <stdint.h>

/* RAM-facing view of one checkpoint.  The on-flash slot adds magic, a
 * monotonic sequence number, a version byte and a CRC32 (32 B total). */
struct juxta_checkpoint_record
{
	uint32_t unix_time;	   /* clock at capture (never 0 for stored records) */
	uint32_t motion_count; /* LIS2DH12 events since the last JXV vitals row */
	int32_t batt_mv;	   /* last battery sample */
	int8_t temp_c;		   /* last LIS2DH12 temperature (0 until first vitals) */
};

/* Scan the ring for the newest valid record and position the write head
 * after it.  Idempotent; safe to call before juxta_settings_init() (touches
 * only external NOR).  Returns 0 on success (including an empty ring),
 * -ENODEV when the flash device is not ready. */
int juxta_checkpoint_init(void);

/* Copy the newest valid record found by the scan into *out.
 * Auto-scans when needed.  Returns 0 on success, -ENOENT when the ring
 * holds no valid record. */
int juxta_checkpoint_load(struct juxta_checkpoint_record *out);

/* Append one record at the write head (erasing the sector on first entry).
 * No-ops with 0 after juxta_checkpoint_disable().  Auto-scans when needed.
 * Called from the system workqueue once per second in production. */
int juxta_checkpoint_write(const struct juxta_checkpoint_record *rec);

/* Erase the whole ring and restart at slot 0 with writes enabled.  Called
 * at every fresh production activation (before op_mode := PROD) and from
 * the clearMemory path so a stale draft can never leak across sessions. */
int juxta_checkpoint_reset(void);

/* Stop accepting writes (shelf entry teardown).  The 1 Hz timer may still
 * fire once more; the queued write becomes a no-op. */
void juxta_checkpoint_disable(void);

/* Erase the ring storage without changing the disabled state.  Used by
 * enter_shelf_mode() after juxta_checkpoint_disable(). */
int juxta_checkpoint_erase(void);

#endif /* JUXTA_CHECKPOINT_H_ */
```

## src/juxta_log.h
```c
#ifndef JUXTA_LOG_H_
#define JUXTA_LOG_H_

#include <stdbool.h>
#include <stddef.h>
#include <stdint.h>

#include "juxta_prod.h"
#include "juxta_settings.h"

enum juxta_log_type
{
	JUXTA_LOG_JXS = 'S',
	JUXTA_LOG_JXV = 'V',
	JUXTA_LOG_JXB = 'B',
};

struct juxta_file_entry
{
	char path[JUXTA_FILE_PATH_LEN];
	uint32_t offset;
	uint32_t length;
	enum juxta_log_type type;
	bool active;
};

struct juxta_log_context
{
	const struct device *flash;
	bool initialized;
	struct juxta_file_entry files[JUXTA_MAX_FILES];
	uint16_t file_count;
	uint32_t active_jxs;
	uint32_t active_jxv;
	uint32_t active_jxb;
	/* Per-region "full" latch indexed by region position in juxta_log.c's
	 * regions[] array: 0 = JXS, 1 = JXV, 2 = JXB.  Set by the bounds-checked
	 * append helper the first time a write would cross the region end, or
	 * by ensure_file when first_erased_offset has reached the region end.
	 * Once latched the region silently drops further writes (and rotations)
	 * so the NOR can never bleed into a neighbouring region.  Cleared by
	 * juxta_log_format() and zero-initialised by juxta_log_init(). */
	bool region_full[3];
};

int juxta_log_init(struct juxta_log_context *ctx, const struct juxta_settings *settings,
				   const char *device_id);
int juxta_log_format(struct juxta_log_context *ctx);

/* Optional progress hook called inside long internal loops (currently the
 * per-sector flash_erase loop inside juxta_log_format).  main.c registers
 * prod_wdt_feed() here so the watchdog is fed during multi-second erases
 * that share a single system-workqueue slot with the periodic feed work
 * (a clearMemory erase therefore starves the periodic feed until it
 * finishes; without this hook the WDT would trip mid-erase).  Implementations
 * must be safe to call from the system workqueue and must not block. */
void juxta_log_set_long_op_tick(void (*tick)(void));
int juxta_log_append_event(struct juxta_log_context *ctx, const struct juxta_settings *settings,
						   const char *device_id, const char *event, uint32_t unix_time);
int juxta_log_append_vitals(struct juxta_log_context *ctx, uint32_t unix_time, uint16_t motion,
							int32_t batt_mv, int8_t temp_c);
int juxta_log_append_ble_observation(struct juxta_log_context *ctx, uint32_t unix_time,
									 const char *observer_id, const char *peer_id, int8_t rssi);
int juxta_log_list_files(struct juxta_log_context *ctx, char *buffer, size_t buffer_size);
int juxta_log_find_file(struct juxta_log_context *ctx, const char *path,
						struct juxta_file_entry *entry);
int juxta_log_read_file(struct juxta_log_context *ctx, const struct juxta_file_entry *entry,
						uint32_t file_offset, uint8_t *buffer, size_t buffer_size,
						size_t *bytes_read);
/* BLE file transfer: CSV body only (no stored filename line, no #EOF trailer). */
uint32_t juxta_log_transfer_payload_bytes(const struct juxta_file_entry *entry);
int juxta_log_read_file_for_transfer(struct juxta_log_context *ctx,
									 const struct juxta_file_entry *entry, uint32_t file_offset,
									 uint8_t *buffer, size_t buffer_size, size_t *bytes_read);
int juxta_log_recover_files(struct juxta_log_context *ctx);
uint8_t juxta_log_memory_level_percent(const struct juxta_log_context *ctx);

#endif /* JUXTA_LOG_H_ */
```

## src/juxta_pof.c
```c
#include "juxta_pof.h"

#include <stddef.h>
#include <string.h>

#include <nrf.h>
#include <nrfx_power.h>

#include <zephyr/kernel.h>
#include <zephyr/logging/log.h>
#include <zephyr/sys/crc.h>
#include <zephyr/toolchain.h>

#include "juxta_time.h"

LOG_MODULE_REGISTER(juxta_pof, LOG_LEVEL_INF);

/* VDDH warning threshold.  The pack sits at ~3.0–4.35 V on VDDH; 3.6 V is
 * well below any healthy operating point yet far above the 2.75 V brownout,
 * so a trip means a genuine transient sag (radio TX + NOR program stack-up)
 * rather than an exhausted battery.
 *
 * The VDD threshold guards the *internal regulated rail*, which runs at the
 * REGOUT0 default of 1.8 V on this board — it MUST be set below that.  A
 * threshold at/above the rail keeps POFWARN permanently asserted, and the
 * errata-242 guard in soc_flash_nrf.c then cancels every internal-flash
 * (NVS) write with -ECANCELED.  1.7 V trips only on a genuine VDD collapse. */
#define JUXTA_POF_THRVDDH NRF_POWER_POFTHRVDDH_V36
#define JUXTA_POF_THR NRF_POWER_POFTHR_V17

/* Retained witness — same magic + CRC pattern as juxta_time_retained. */
#define JUXTA_POF_RETAINED_MAGIC 0x4A585057U /* 'JXPW' */
#define JUXTA_POF_RETAINED_VERSION 1U

struct juxta_pof_retained
{
	uint32_t magic;
	uint8_t version;
	uint8_t _pad[3];
	struct juxta_pof_witness w;
	uint32_t crc32;
};

static struct juxta_pof_retained s_retained __noinit;

/* Previous-life witness snapshotted before s_retained is reset for this
 * life; consumed by main.c once the clock is valid. */
static struct juxta_pof_witness s_prev_life;
static bool s_prev_life_valid;

static size_t retained_crc_span(void)
{
	return offsetof(struct juxta_pof_retained, crc32);
}

static uint32_t retained_compute_crc(const struct juxta_pof_retained *r)
{
	return crc32_ieee((const uint8_t *)r, retained_crc_span());
}

static bool retained_valid(const struct juxta_pof_retained *r)
{
	return r->magic == JUXTA_POF_RETAINED_MAGIC &&
		   r->version == JUXTA_POF_RETAINED_VERSION && r->w.count > 0U &&
		   r->crc32 == retained_compute_crc(r);
}

static void retained_reset(void)
{
	memset(&s_retained, 0, sizeof(s_retained));
	s_retained.magic = JUXTA_POF_RETAINED_MAGIC;
	s_retained.version = JUXTA_POF_RETAINED_VERSION;
	s_retained.crc32 = retained_compute_crc(&s_retained);
}

/* POWER_CLOCK IRQ context (dispatched via nrfx_power_irq_handler).  Keep it
 * to a struct update + CRC: no logging, no kernel objects. */
static void pof_warn_handler(void)
{
	int64_t up = k_uptime_get();
	uint32_t now = juxta_time_now();

	if (s_retained.w.count == 0U)
	{
		s_retained.w.first_uptime_ms = up;
		s_retained.w.first_unix = now;
	}
	s_retained.w.count++;
	s_retained.w.last_uptime_ms = up;
	s_retained.w.last_unix = now;
	s_retained.crc32 = retained_compute_crc(&s_retained);
}

void juxta_pof_init(void)
{
	if (retained_valid(&s_retained))
	{
		s_prev_life = s_retained.w;
		s_prev_life_valid = true;
		LOG_WRN("POF witness from previous life: count=%u first_up=%lld ms last_up=%lld ms",
				s_prev_life.count, (long long)s_prev_life.first_uptime_ms,
				(long long)s_prev_life.last_uptime_ms);
	}

	retained_reset();

	/* Bench guard: with a J-Link attached the board is typically powered
	 * without a battery, so VDDH sits below the 3.6 V threshold and
	 * POFWARN would assert permanently — spamming the witness and letting
	 * the errata-242 guard in soc_flash_nrf.c cancel NVS writes with
	 * -ECANCELED.  Same debugger gate as the battery checks in main.c. */
	if ((CoreDebug->DHCSR & CoreDebug_DHCSR_C_DEBUGEN_Msk) != 0U)
	{
		LOG_INF("POF not armed (debugger attached)");
		return;
	}

	static const nrfx_power_pofwarn_config_t pof_config = {
		.handler = pof_warn_handler,
		.thr = JUXTA_POF_THR,
		.thrvddh = JUXTA_POF_THRVDDH,
	};

	nrfx_power_pof_init(&pof_config);
	nrfx_power_pof_enable(&pof_config);
	LOG_INF("POF armed: VDDH thr 3.6 V, VDD thr 1.7 V");
}

bool juxta_pof_hit_this_life(void)
{
	return retained_valid(&s_retained);
}

bool juxta_pof_prev_life(struct juxta_pof_witness *out)
{
	if (!s_prev_life_valid || !out)
	{
		return false;
	}

	*out = s_prev_life;
	return true;
}

void juxta_pof_prev_life_clear(void)
{
	memset(&s_prev_life, 0, sizeof(s_prev_life));
	s_prev_life_valid = false;
}

void juxta_pof_disarm(void)
{
	nrfx_power_pof_disable();
}
```

## src/juxta_pof.h
```c
#ifndef JUXTA_POF_H_
#define JUXTA_POF_H_

#include <stdbool.h>
#include <stdint.h>

/* POFCON supply-droop witness (crash analysis §5.4).
 *
 * Arms the nRF52840 power-fail comparator so a VDDH sag below the warning
 * threshold fires an IRQ while the CPU still has headroom to write a
 * `.noinit` witness struct.  The struct survives soft resets (DOG / LOCKUP /
 * SREQ) but is wiped by a true POR — which is itself informative: a clean
 * POR with *no* witness is ESD-class or a full supply collapse, while a
 * witness followed by a reset proves the supply sagged first.
 *
 * The witness from the previous life is snapshotted at juxta_pof_init() and
 * exposed via juxta_pof_prev_life() so main.c can emit a `pof_witness` JXS
 * row once the clock is valid.
 */

struct juxta_pof_witness
{
	uint32_t count;			/* POFWARN events this life */
	int64_t first_uptime_ms;	/* uptime at first event */
	int64_t last_uptime_ms;		/* uptime at most recent event */
	uint32_t first_unix;		/* clock at first event (0 if unset) */
	uint32_t last_unix;		/* clock at most recent event (0 if unset) */
};

/* Snapshot any witness left by the previous life, reset the retained struct
 * for this life, and arm the comparator.  Call once, early in main(). */
void juxta_pof_init(void);

/* True if POFWARN has fired at least once since this boot's juxta_pof_init(). */
bool juxta_pof_hit_this_life(void);

/* Witness carried over from the previous life (survived a soft reset).
 * Returns true and fills `out` when one exists; consume-once semantics via
 * juxta_pof_prev_life_clear() after the JXS row has been appended. */
bool juxta_pof_prev_life(struct juxta_pof_witness *out);
void juxta_pof_prev_life_clear(void);

/* Disable the comparator (called on shelf entry; System OFF disables the
 * POF block anyway, this just makes the teardown explicit). */
void juxta_pof_disarm(void);

#endif /* JUXTA_POF_H_ */
```

## src/juxta_prod.h
```c
#ifndef JUXTA_PROD_H_
#define JUXTA_PROD_H_

#include <stdint.h>

#define JUXTA_PRODUCT_NAME "Juxta5-8"
#define JUXTA_FIRMWARE_VERSION "5.8.4"
#define JUXTA_LOG_SCHEMA "jxta-nor-csv-v5"
#define JUXTA_LOGGING_VERSION 5

#define JUXTA_DEVICE_ID_LEN 10
#define JUXTA_SUBJECT_ID_LEN 32
#define JUXTA_EXPERIMENT_LEN 32
#define JUXTA_UPLOAD_PATH_LEN 32
#define JUXTA_MODE_LEN 16

#define JUXTA_DEFAULT_SCAN_INTERVAL_S 30U
#define JUXTA_DEFAULT_VITALS_INTERVAL_S 60U
#define JUXTA_DEFAULT_ADV_INTERVAL_S 5U
/* Non-connectable adv cadence and passive scan burst cadence (seconds), NVS + Gateway.
 * Whole-second integers 0 through JUXTA_MAX_BLE_INTERVAL_S inclusive (0 = that modality off).
 * No stepping; values above the max are clamped on save. */
#define JUXTA_MAX_BLE_INTERVAL_S 120U
/* After a vitals window with zero LIS2DH12 motion, passive scan cadence uses
 * scan_interval_s × inactivity_multiplier (capped at JUXTA_MAX_BLE_INTERVAL_S). */
#define JUXTA_DEFAULT_INACTIVITY_MULTIPLIER 1U
#define JUXTA_MAX_INACTIVITY_MULTIPLIER 10U
/* Node `upload_path` and NVS field (single hard-coded path until app-driven paths return). */
#define JUXTA_UPLOAD_PATH_FIXED "/"
#define JUXTA_DEFAULT_UPLOAD_PATH JUXTA_UPLOAD_PATH_FIXED

/* Runtime file-path buffer (BLE listing, find, transfer).
 * Filenames are "JXByyyymmdd.csv" = 15 chars + null. Use 20 for headroom so
 * read_line() can read the full name and still find the trailing '\n'. */
#define JUXTA_FILE_NAME_LEN 20
#define JUXTA_FILE_PATH_LEN 64
/* NVS-backed cache uses a tighter name field to keep the struct small.
 * Filenames are at most "JXS20260507.csv" = 15 chars + null. */
#define JUXTA_CACHE_NAME_LEN 20
/* 3 log types × up to 16 days = 48; sized for 7–12 day deployments with
 * margin.  The NVS-backed juxta_log_cache (8 B header + 32 B per file) is
 * ~1.5 KB at 48 entries — well under a 4 KB internal-flash sector and well
 * under the per-entry write limit of the SETTINGS_NVS backend. */
#define JUXTA_MAX_FILES 48
#define JUXTA_TRANSFER_CHUNK_SIZE 512

/* Persisted operating mode (NVS-backed; see juxta_settings_get_op_mode /
 * juxta_settings_set_op_mode).  The recovery-on-silent-reset boot branch in
 * main.c only attempts to resume production when this is PROD, so DFU- and
 * shelf-mode units never accidentally fall into the recovery path. */
enum juxta_op_mode
{
	JUXTA_OP_MODE_SHELF = 0, /* default — power-on, shelf, after magnet/gateway-driven exit */
	JUXTA_OP_MODE_PROD = 1,	 /* production init completed; recovery target */
	JUXTA_OP_MODE_DFU = 2,	 /* DFU mode entered */
};

/* Why the device entered shelf mode (System OFF).  Persisted in the NVS
 * breadcrumb at every enter_shelf_mode() so the *next* valid-clock boot can
 * append a `crumb_<reason>` JXS row — converting previously-silent shelf
 * entries (fresh power-on, battery gate) into attributable events. */
enum juxta_shelf_reason
{
	JUXTA_SHELF_REASON_UNKNOWN = 0,
	JUXTA_SHELF_REASON_FRESH_BOOT = 1,	   /* RESETREAS == 0 (true power-on / battery insertion) */
	JUXTA_SHELF_REASON_BATT_GATE = 2,	   /* Step 3b early battery gate (< brownout at wake) */
	JUXTA_SHELF_REASON_FALSE_POSITIVE = 3, /* sub-debounce magnet hold on System OFF wake */
	JUXTA_SHELF_REASON_MAGNET = 4,		   /* confirmed magnet hold during production */
	JUXTA_SHELF_REASON_DFU_EXIT = 5,	   /* magnet hold in DFU monitor */
	JUXTA_SHELF_REASON_BROWNOUT = 6,	   /* vitals-tick brownout (< brownout in production) */
	JUXTA_SHELF_REASON_GATEWAY_RESET = 7,  /* gateway "reset" command */
};

#endif /* JUXTA_PROD_H_ */
```

## src/juxta_settings.c
```c
#include "juxta_settings.h"

#include <errno.h>
#include <stdio.h>
#include <string.h>

#include <zephyr/logging/log.h>
#include <zephyr/settings/settings.h>

LOG_MODULE_REGISTER(juxta_settings, LOG_LEVEL_INF);

#define SETTINGS_SUBTREE "juxta_prod"
#define SETTINGS_KEY_CURRENT "current"
#define SETTINGS_KEY_LOG_CACHE "log_cache"
#define SETTINGS_KEY_OP_MODE "op_mode"
#define SETTINGS_KEY_BOOT_COUNT "boot_count"
#define SETTINGS_KEY_BREADCRUMB "crumb"
#define LOG_CACHE_MAGIC 0x4A584C43U /* JXLC */
#define LOG_CACHE_VERSION 1U
#define JUXTA_BREADCRUMB_MAGIC 0x4A584243U /* JXBC */
#define JUXTA_BREADCRUMB_VERSION 1U

static struct juxta_settings current_settings;
static struct juxta_log_cache current_log_cache;
static bool loaded_settings;
static bool loaded_log_cache;
/* One-byte persisted operating mode (NVS).  Defaults to SHELF before any
 * setter runs so the cold-boot / first-flash path naturally lands in shelf. */
static uint8_t current_op_mode = (uint8_t)JUXTA_OP_MODE_SHELF;
static char boot_device_id[JUXTA_DEVICE_ID_LEN];
static uint32_t current_boot_count;
static struct juxta_breadcrumb current_breadcrumb;
static bool loaded_breadcrumb;

static void copy_string(char *dst, size_t dst_size, const char *src)
{
	if (dst_size == 0U)
	{
		return;
	}

	if (!src || src[0] == '\0')
	{
		dst[0] = '\0';
		return;
	}

	(void)snprintf(dst, dst_size, "%s", src);
}

void juxta_settings_defaults(struct juxta_settings *settings, const char *device_id)
{
	memset(settings, 0, sizeof(*settings));
	copy_string(settings->subject_id, sizeof(settings->subject_id),
				(device_id && device_id[0] != '\0') ? device_id : "JX_000000");
	copy_string(settings->upload_path, sizeof(settings->upload_path), JUXTA_DEFAULT_UPLOAD_PATH);
	settings->scan_interval_s = JUXTA_DEFAULT_SCAN_INTERVAL_S;
	settings->vitals_interval_s = JUXTA_DEFAULT_VITALS_INTERVAL_S;
	settings->adv_interval_s = JUXTA_DEFAULT_ADV_INTERVAL_S;
	settings->inactivity_multiplier = JUXTA_DEFAULT_INACTIVITY_MULTIPLIER;
	settings->motion_logging = 1U;
}

static int settings_set(const char *key, size_t len, settings_read_cb read_cb, void *cb_arg)
{
	if (strcmp(key, SETTINGS_KEY_CURRENT) == 0)
	{
		if (len != sizeof(current_settings))
		{
			LOG_WRN("Ignoring settings size %zu expected %zu", len, sizeof(current_settings));
			return -EINVAL;
		}

		int rc = read_cb(cb_arg, &current_settings, sizeof(current_settings));
		if (rc >= 0)
		{
			loaded_settings = true;
			return 0; /* settings_read_cb returns byte count; subsystem expects 0 */
		}
		return rc;
	}

	if (strcmp(key, SETTINGS_KEY_LOG_CACHE) == 0)
	{
		if (len != sizeof(current_log_cache))
		{
			LOG_WRN("Ignoring log cache size %zu expected %zu", len, sizeof(current_log_cache));
			return -EINVAL;
		}

		int rc = read_cb(cb_arg, &current_log_cache, sizeof(current_log_cache));
		if (rc >= 0 && current_log_cache.magic == LOG_CACHE_MAGIC &&
			current_log_cache.version == LOG_CACHE_VERSION &&
			current_log_cache.file_count <= JUXTA_MAX_FILES)
		{
			loaded_log_cache = true;
		}
		return (rc >= 0) ? 0 : rc;
	}

	if (strcmp(key, SETTINGS_KEY_BOOT_COUNT) == 0)
	{
		if (len != sizeof(current_boot_count))
		{
			LOG_WRN("Ignoring boot_count size %zu expected %zu", len,
					sizeof(current_boot_count));
			return -EINVAL;
		}

		uint32_t stored = 0U;
		int rc = read_cb(cb_arg, &stored, sizeof(stored));
		if (rc >= 0)
		{
			/* Keep the larger value: the early-boot increment may already
			 * have bumped the RAM copy before the subtree load runs. */
			if (stored > current_boot_count)
			{
				current_boot_count = stored;
			}
			return 0;
		}
		return rc;
	}

	if (strcmp(key, SETTINGS_KEY_BREADCRUMB) == 0)
	{
		if (len != sizeof(current_breadcrumb))
		{
			LOG_WRN("Ignoring breadcrumb size %zu expected %zu", len,
					sizeof(current_breadcrumb));
			return -EINVAL;
		}

		int rc = read_cb(cb_arg, &current_breadcrumb, sizeof(current_breadcrumb));
		if (rc >= 0 && current_breadcrumb.magic == JUXTA_BREADCRUMB_MAGIC &&
			current_breadcrumb.version == JUXTA_BREADCRUMB_VERSION)
		{
			loaded_breadcrumb = true;
		}
		return (rc >= 0) ? 0 : rc;
	}

	if (strcmp(key, SETTINGS_KEY_OP_MODE) == 0)
	{
		if (len != sizeof(current_op_mode))
		{
			LOG_WRN("Ignoring op_mode size %zu expected %zu", len,
					sizeof(current_op_mode));
			return -EINVAL;
		}

		uint8_t stored = 0U;
		int rc = read_cb(cb_arg, &stored, sizeof(stored));
		if (rc >= 0)
		{
			/* Sanitize: unknown values fall back to SHELF, which is the
			 * safest default when we cannot trust the persisted byte. */
			if (stored == (uint8_t)JUXTA_OP_MODE_PROD ||
				stored == (uint8_t)JUXTA_OP_MODE_DFU ||
				stored == (uint8_t)JUXTA_OP_MODE_SHELF)
			{
				current_op_mode = stored;
			}
			else
			{
				LOG_WRN("Unknown op_mode=%u in NVS, defaulting to SHELF", stored);
				current_op_mode = (uint8_t)JUXTA_OP_MODE_SHELF;
			}
			return 0;
		}
		return rc;
	}

	return -ENOENT;
}

SETTINGS_STATIC_HANDLER_DEFINE(juxta_prod, SETTINGS_SUBTREE, NULL, settings_set, NULL, NULL);

static void sanitize_settings(struct juxta_settings *settings)
{
	settings->subject_id[sizeof(settings->subject_id) - 1] = '\0';
	settings->experiment[sizeof(settings->experiment) - 1] = '\0';
	settings->upload_path[sizeof(settings->upload_path) - 1] = '\0';

	if (settings->subject_id[0] == '\0')
	{
		copy_string(settings->subject_id, sizeof(settings->subject_id), boot_device_id);
	}
	/* Fixed product policy: always `/` in RAM and on save (Node + NVS). */
	copy_string(settings->upload_path, sizeof(settings->upload_path), JUXTA_UPLOAD_PATH_FIXED);
	/* 0 = disable non-connectable advertising; otherwise 1..JUXTA_MAX_BLE_INTERVAL_S (any integer). */
	if (settings->adv_interval_s > JUXTA_MAX_BLE_INTERVAL_S)
	{
		settings->adv_interval_s = JUXTA_MAX_BLE_INTERVAL_S;
	}
	/* 0 = disable passive scan bursts; otherwise 1..JUXTA_MAX_BLE_INTERVAL_S (any integer). */
	if (settings->scan_interval_s > JUXTA_MAX_BLE_INTERVAL_S)
	{
		settings->scan_interval_s = JUXTA_MAX_BLE_INTERVAL_S;
	}
	if (settings->vitals_interval_s == 0U)
	{
		settings->vitals_interval_s = JUXTA_DEFAULT_VITALS_INTERVAL_S;
	}
	if (settings->inactivity_multiplier == 0U ||
	    settings->inactivity_multiplier > JUXTA_MAX_INACTIVITY_MULTIPLIER)
	{
		if (settings->inactivity_multiplier > JUXTA_MAX_INACTIVITY_MULTIPLIER)
		{
			settings->inactivity_multiplier = JUXTA_MAX_INACTIVITY_MULTIPLIER;
		}
		else
		{
			settings->inactivity_multiplier = JUXTA_DEFAULT_INACTIVITY_MULTIPLIER;
		}
	}
	if (settings->motion_logging > 1U)
	{
		settings->motion_logging = 1U;
	}
	else if (settings->motion_logging == 0U && settings->settings_reserved[0] == 0U)
	{
		/* Legacy NVS: this byte was settings_reserved[0] (always 0). */
		settings->motion_logging = 1U;
	}
}

int juxta_settings_init(const char *device_id)
{
	int rc;

	copy_string(boot_device_id, sizeof(boot_device_id),
				(device_id && device_id[0] != '\0') ? device_id : "JX_000000");
	juxta_settings_defaults(&current_settings, boot_device_id);

	rc = settings_subsys_init();
	if (rc != 0 && rc != -EALREADY)
	{
		LOG_ERR("settings_subsys_init failed: %d", rc);
		return rc;
	}

	rc = settings_load_subtree(SETTINGS_SUBTREE);
	if (rc != 0)
	{
		LOG_WRN("settings_load_subtree failed: %d; using defaults", rc);
	}

	if (!loaded_settings)
	{
		LOG_INF("No saved settings; storing defaults");
		rc = juxta_settings_update(&current_settings);
		if (rc != 0)
		{
			return rc;
		}
	}
	else
	{
		sanitize_settings(&current_settings);
	}

	LOG_INF("settings subject=%s experiment=%s scan=%us adv=%us vitals=%us inactivity_multiplier=%u motion_logging=%u",
			current_settings.subject_id, current_settings.experiment,
			current_settings.scan_interval_s, current_settings.adv_interval_s,
			current_settings.vitals_interval_s,
			(unsigned int)current_settings.inactivity_multiplier,
			(unsigned int)current_settings.motion_logging);
	return 0;
}

const struct juxta_settings *juxta_settings_get(void)
{
	return &current_settings;
}

int juxta_settings_update(const struct juxta_settings *settings)
{
	struct juxta_settings next;
	int rc;

	if (!settings)
	{
		return -EINVAL;
	}

	next = *settings;
	sanitize_settings(&next);

	rc = settings_save_one(SETTINGS_SUBTREE "/" SETTINGS_KEY_CURRENT, &next, sizeof(next));
	if (rc != 0)
	{
		LOG_ERR("settings_save_one current failed: %d", rc);
		return rc;
	}

	current_settings = next;
	loaded_settings = true;
	return 0;
}

int juxta_settings_load_log_cache(struct juxta_log_cache *cache)
{
	if (!cache)
	{
		return -EINVAL;
	}
	if (!loaded_log_cache)
	{
		return -ENOENT;
	}

	*cache = current_log_cache;
	return 0;
}

int juxta_settings_save_log_cache(const struct juxta_log_cache *cache)
{
	/* Static: keeps the 520-byte struct off thread stacks. This function is
	 * only called from ensure_file() (file creation) which runs infrequently
	 * and not concurrently with itself. */
	static struct juxta_log_cache next;
	int rc;

	if (!cache || cache->file_count > JUXTA_MAX_FILES)
	{
		return -EINVAL;
	}

	next = *cache;
	next.magic = LOG_CACHE_MAGIC;
	next.version = LOG_CACHE_VERSION;

	rc = settings_save_one(SETTINGS_SUBTREE "/" SETTINGS_KEY_LOG_CACHE, &next, sizeof(next));
	if (rc != 0)
	{
		LOG_WRN("settings_save_one log cache failed: %d", rc);
		return rc;
	}

	current_log_cache = next;
	loaded_log_cache = true;
	return 0;
}

int juxta_settings_clear_log_cache(void)
{
	memset(&current_log_cache, 0, sizeof(current_log_cache));
	loaded_log_cache = false;
	return settings_delete(SETTINGS_SUBTREE "/" SETTINGS_KEY_LOG_CACHE);
}

enum juxta_op_mode juxta_settings_get_op_mode(void)
{
	return (enum juxta_op_mode)current_op_mode;
}

int juxta_settings_set_op_mode(enum juxta_op_mode mode)
{
	uint8_t next = (uint8_t)mode;

	/* Sanitize at the boundary so a bad argument cannot poison NVS. */
	if (mode != JUXTA_OP_MODE_SHELF && mode != JUXTA_OP_MODE_PROD &&
		mode != JUXTA_OP_MODE_DFU)
	{
		LOG_ERR("Refusing to save unknown op_mode=%u", next);
		return -EINVAL;
	}

	/* Skip the write when value is unchanged: minimises NVS wear over the
	 * many shelf-PROD-shelf cycles a unit goes through during testing. */
	if (next == current_op_mode)
	{
		return 0;
	}

	int rc = settings_save_one(SETTINGS_SUBTREE "/" SETTINGS_KEY_OP_MODE, &next,
							   sizeof(next));
	if (rc != 0)
	{
		LOG_ERR("settings_save_one op_mode failed: %d", rc);
		return rc;
	}

	current_op_mode = next;
	LOG_INF("op_mode := %u", next);
	return 0;
}

/* ---------------------------------------------------------------------------
 * Boot counter + forensic breadcrumb
 *
 * Both must be usable *before* juxta_settings_init(): the fresh-boot and
 * Step 3b battery-gate shelf entries run at the very top of main(), long
 * before Step 7.  settings_subsys_init() is idempotent (-EALREADY on repeat
 * calls) so each entry point below simply ensures it has run.
 * -------------------------------------------------------------------------*/
static int ensure_settings_subsys(void)
{
	int rc = settings_subsys_init();

	if (rc != 0 && rc != -EALREADY)
	{
		LOG_ERR("settings_subsys_init failed: %d", rc);
		return rc;
	}
	return 0;
}

/* Direct single-key loader used before the full subtree load has happened. */
static int boot_count_direct_cb(const char *key, size_t len, settings_read_cb read_cb,
								void *cb_arg, void *param)
{
	uint32_t *out = param;

	ARG_UNUSED(key);
	if (len == sizeof(*out))
	{
		(void)read_cb(cb_arg, out, sizeof(*out));
	}
	return 0;
}

static int op_mode_direct_cb(const char *key, size_t len, settings_read_cb read_cb,
							 void *cb_arg, void *param)
{
	uint8_t *out = param;

	ARG_UNUSED(key);
	if (len == sizeof(*out))
	{
		(void)read_cb(cb_arg, out, sizeof(*out));
	}
	return 0;
}

enum juxta_op_mode juxta_settings_read_op_mode_early(void)
{
	if (ensure_settings_subsys() != 0)
	{
		return JUXTA_OP_MODE_SHELF;
	}

	uint8_t stored = (uint8_t)JUXTA_OP_MODE_SHELF;

	(void)settings_load_subtree_direct(SETTINGS_SUBTREE "/" SETTINGS_KEY_OP_MODE,
									   op_mode_direct_cb, &stored);

	if (stored != (uint8_t)JUXTA_OP_MODE_PROD && stored != (uint8_t)JUXTA_OP_MODE_DFU &&
		stored != (uint8_t)JUXTA_OP_MODE_SHELF)
	{
		return JUXTA_OP_MODE_SHELF;
	}
	return (enum juxta_op_mode)stored;
}

int juxta_settings_boot_count_increment(void)
{
	int rc = ensure_settings_subsys();

	if (rc != 0)
	{
		return rc;
	}

	uint32_t stored = 0U;

	(void)settings_load_subtree_direct(SETTINGS_SUBTREE "/" SETTINGS_KEY_BOOT_COUNT,
									   boot_count_direct_cb, &stored);
	if (stored > current_boot_count)
	{
		current_boot_count = stored;
	}

	current_boot_count++;
	rc = settings_save_one(SETTINGS_SUBTREE "/" SETTINGS_KEY_BOOT_COUNT,
						   &current_boot_count, sizeof(current_boot_count));
	if (rc != 0)
	{
		LOG_ERR("settings_save_one boot_count failed: %d", rc);
		return rc;
	}

	LOG_INF("boot_count := %u", current_boot_count);
	return 0;
}

uint32_t juxta_settings_boot_count(void)
{
	return current_boot_count;
}

int juxta_settings_save_breadcrumb(const struct juxta_breadcrumb *crumb)
{
	struct juxta_breadcrumb next;
	int rc;

	if (!crumb)
	{
		return -EINVAL;
	}

	rc = ensure_settings_subsys();
	if (rc != 0)
	{
		return rc;
	}

	next = *crumb;
	next.magic = JUXTA_BREADCRUMB_MAGIC;
	next.version = JUXTA_BREADCRUMB_VERSION;

	rc = settings_save_one(SETTINGS_SUBTREE "/" SETTINGS_KEY_BREADCRUMB, &next,
						   sizeof(next));
	if (rc != 0)
	{
		LOG_ERR("settings_save_one breadcrumb failed: %d", rc);
		return rc;
	}

	current_breadcrumb = next;
	loaded_breadcrumb = true;
	return 0;
}

int juxta_settings_load_breadcrumb(struct juxta_breadcrumb *out)
{
	if (!out)
	{
		return -EINVAL;
	}
	if (!loaded_breadcrumb)
	{
		return -ENOENT;
	}

	*out = current_breadcrumb;
	return 0;
}

int juxta_settings_clear_breadcrumb(void)
{
	memset(&current_breadcrumb, 0, sizeof(current_breadcrumb));
	loaded_breadcrumb = false;
	return settings_delete(SETTINGS_SUBTREE "/" SETTINGS_KEY_BREADCRUMB);
}
```
